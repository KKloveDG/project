AUTOSAR XML (schema 00044)
package /ComponentTypes
  composition sw component type CtCoApplication
    5 x component:
      CpApMySwc: type=CtApMySwc
      CpSaDoorFrontLeft: type=CtSaDoor
      CpSalnteriorLight: type=CtSalnteriorLight
      CpSaDoorFrontRight: type=CtSaDoor
      CtCddloHwAb: type=CtCddloHwAb
    connect CpApMySwc.PpLightStateFront -> CpSalnteriorLight.PpLightstate
    connect CpSaDoorFrontLeft.PpDoorState -> CpApMySwc.PpDoorStateFrontLeft
    connect CpSaDoorFrontRight.PpDoorState -> CpApMySwc.PpDoorStateFrontRight
    connect CtCddloHwAb.PpInteriorLightFront -> CpSalnteriorLight.PpInteriorLightloHwAb
    connect CtCddloHwAb.PpDoorFrontLeft -> CpSaDoorFrontLeft.PpDoorloHwAb
    connect CtCddloHwAb.PpDoorFrontRight -> CpSaDoorFrontRight.PpDoorloHwAb
