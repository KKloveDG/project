AUTOSAR XML (schema 00044)
package /ComponentTypes
  composition sw component type CtCoApplication
    4 x component:
      CpApMySwc: type=CtApMySwc
      CpSaDoorFrontLeft: type=CtSaDoor
      CpSalnteriorLight: type=CtSalnteriorLight
      CpSaDoorFrontRight: type=CtSaDoor
    connect CpApMySwc.PpLightStateFront -> CpSalnteriorLight.PpLightstate
    connect CpSaDoorFrontLeft.PpDoorState -> CpApMySwc.PpDoorStateFrontLeft
    connect CpSaDoorFrontRight.PpDoorState -> CpApMySwc.PpDoorStateFrontRight
