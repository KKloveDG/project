AUTOSAR XML (schema 00044)
package /ComponentTypes
  sensor actuator sw component type CtSalnteriorLight
    require port PpLightstate: nonqueued-receiver-com-spec{data-element=DeLightstate, init-value=constant-reference=Clightoff}, required-interface=PiLightstate
    behavior CtSalnteriorLight_InternalBehavior: supports-multiple-instantiation=true
  swc implementation CtSalnteriorLight_Implementation: behavior=CtSalnteriorLight_InternalBehavior
