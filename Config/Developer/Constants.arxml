AUTOSAR XML (schema 00044)
package /Constants
  constant specification Clightoff: value-spec=0
  constant specification CDoorClosed: value-spec=0
  constant specification COdometerDefault: value-spec=0
