AUTOSAR XML (schema 00044)
standard types defined: uint8
package /ComponentTypes/DataTypeMappingSets
  data type mapping set DemoTypeMapping
    data-type-maps:
      application-data-type=AdtLightstate, implementation-data-type=IdtLightstate
      application-data-type=AdtDoorState, implementation-data-type=IdtDoorState
      application-data-type=AdtOdomter, implementation-data-type=uint64
package /Predefined_DEV/ImplementationDataTypes
  impl type NvM_RequestResultType: compu {0=NVM_REQ_OK, 1=NVM_REQ_NOT_OK, 2=NVM_REQ_PENDING, 3=NVM_REQ_INTEGRITY_FAILED, 4=NVM_REQ_BLOCK_SKIPPED, 5=NVM_REQ_NV_INVALIDATED, 6=NVM_REQ_CANCELED, 7=NVM_REQ_REDUNDANCY_FAILED, 8=NVM_REQ_RESTORED_FROM_ROM}, implementation-data-type=uint8
  impl type NvM_ServiceIdType: compu {6=NVM_READ_BLOCK, 7=NVM_WRITE_BLOCK, 8=NVM_RESTORE_BLOCK_DEFAULTS, 9=NVM_ERASE_BLOCK, 11=NVM_INVALIDATE_NV_BLOCK, 12=NVM_READ_ALL}, implementation-data-type=uint8
  impl type Dem_UdsStatusByteType: compu {mask 1: 1=DEM_UDS_STATUS_TF, mask 2: 2=DEM_UDS_STATUS_TFTOC, mask 4: 4=DEM_UDS_STATUS_PDTC, mask 8: 8=DEM_UDS_STATUS_CDTC, mask 16: 16=DEM_UDS_STATUS_TNCSLC, mask 32: 32=DEM_UDS_STATUS_TFSLC, mask 64: 64=DEM_UDS_STATUS_TNCTOC, mask 128: 128=DEM_UDS_STATUS_WIR}, range raw 0..255, implementation-data-type=uint8
package /DataTypes
  app type AdtDoorState: category=BOOLEAN, sw-calibration-access=READ-ONLY
  app type AdtLightstate: category=BOOLEAN, sw-calibration-access=READ-ONLY
  impl type IdtDoorState1: compu-method=boolean_CompuMethod, implementation-data-type=boolean, type-emitter=RTE
  impl type IdtLightstate1: compu-method=boolean_CompuMethod, implementation-data-type=boolean, type-emitter=RTE
  impl type IdtDioValueType: implementation-data-type=uint8, type-emitter=RTE
  app type AdtOdomter: category=VALUE, sw-calibration-access=READ-ONLY
  impl type IdtDoorState: compu-method=boolean_CompuMethod, implementation-data-type=boolean, type-emitter=RTE
  impl type IdtLightstate: compu-method=boolean_CompuMethod, implementation-data-type=boolean, type-emitter=RTE
package /DataType/Semantics
  compu method CM_PpLDoorState: 0=Cx0_Off, 1=Cx1_Open
  compu method CM_PpLightState: 0=Cx0_Off, 1=Cx1_On
  compu method CM_PpRDoorState: 0=Cx0_Off, 1=Cx1_Open
