AUTOSAR XML (schema 4-2-1)
package /InitialEcuC
  ecuc value collection InitialEcuC: ecuc-values=[Can, CanIf, CanSM, Com, ComM, EcuC, EcuM, PduR]
  module config Can
    CanConfigSet
      CT_CAN00_ff4fcc05 (CanController):
        CanControllerActivation = true
        CanControllerDefaultBaudrate = CanControllerBaudrateConfig
        CanControllerSystemRef = CT_CAN00
        CanWakeupSourceRef = EcuMCommonConfiguration/CN_CAN00_3ce10f85
        CanControllerBaudrateConfig
      CN_CAN00_3ce10f85_Tx (CanHardwareObject): CanHandleType=BASIC, CanIdValue=0, CanObjectType=TRANSMIT, CanControllerRef=CanConfigSet/CT_CAN00_ff4fcc05
    CanGeneral: CanIndex=0
  module config CanIf
    CanIfCtrlDrvCfg_7d254554 (CanIfCtrlDrvCfg): CanIfCtrlDrvInitHohConfigRef=CanIfInitHohCfg, CanIfCtrlDrvNameRef=CanGeneral
      CT_CAN00_ff4fcc05 (CanIfCtrlCfg): CanIfCtrlCanCtrlRef=CanConfigSet/CT_CAN00_ff4fcc05
    CanIfInitCfg
      CHNL_0fb271d2 (CanIfBufferCfg): CanIfBufferSize=0, CanIfBufferHthRef=CanIfInitHohCfg/CN_CAN00_3ce10f85_Tx
      CanIfInitHohCfg: CanIfInitRefCfgSet=CanConfigSet
        CN_CAN00_3ce10f85_Tx (CanIfHthCfg): CanIfHthCanCtrlIdRef=CanIfCtrlDrvCfg_7d254554/CT_CAN00_ff4fcc05, CanIfHthIdSymRef=CanConfigSet/CN_CAN00_3ce10f85_Tx
      3 x CanIfTxPduCfg, all with CanIfTxPduCanIdType=STANDARD_CAN, CanIfTxPduDlc=8, CanIfTxPduUserTxConfirmationName=PduR_CanIfTxConfirmation, CanIfTxPduUserTxConfirmationUL=PDUR, CanIfTxPduBufferRef=CanIfInitCfg/CHNL_0fb271d2:
        PpDoorStateFrontLeft_oCAN00_2cd6f4bb_Tx: CanIfTxPduCanId=293, CanIfTxPduRef=EcucPduCollection/PpDoorStateFrontLeft_oCAN00_d010a217_Tx
        PpDoorStateFrontRight_oCAN00_c931c05d_Tx: CanIfTxPduCanId=292, CanIfTxPduRef=EcucPduCollection/PpDoorStateFrontRight_oCAN00_7113e5c3_Tx
        PpLightStateFront_oCAN00_b1ad26f2_Tx: CanIfTxPduCanId=291, CanIfTxPduRef=EcucPduCollection/PpLightStateFront_oCAN00_53fe974e_Tx
    CanIfPrivateCfg: CanIfPrivateSoftwareFilterType=LINEAR
    CanIfPublicCfg: CanIfPublicPnSupport=false
  module config CanSM
    CanSMConfiguration
      CHNL_0fb271d2 (CanSMManagerNetwork): CanSMComMNetworkHandleRef=ComMConfigSet/CN_CAN00_3ce10f85
        CT_CAN00_3bdc4e64 (CanSMController): CanSMControllerId=CanIfCtrlDrvCfg_7d254554/CT_CAN00_ff4fcc05
  module config Com
    ComConfig
      3 x ComIPdu, all with ComIPduDirection=SEND, ComIPduType=NORMAL, ComIPduGroupRef=Veh_Door_oCAN00_Tx_2fd3c8d8:
        PpDoorStateFrontLeft_oCAN00_401cef01_Tx: ComIPduSignalRef=PpLDoorState_oPpDoorStateFrontLeft_oCAN00_77696575_Tx, ComPduIdRef=EcucPduCollection/PpDoorStateFrontLeft_oCAN00_401cef01_Tx
          ComTxIPdu: ComTxIPduUnusedAreasDefault=0
        PpDoorStateFrontRight_oCAN00_c9449d55_Tx: ComIPduSignalRef=PpRDoorState_oPpDoorStateFrontRight_oCAN00_45f6beeb_Tx, ComPduIdRef=EcucPduCollection/PpDoorStateFrontRight_oCAN00_c9449d55_Tx
          ComTxIPdu: ComTxIPduUnusedAreasDefault=0
        PpLightStateFront_oCAN00_7d4af1fd_Tx: ComIPduSignalRef=PpLightState_oPpLightStateFront_oCAN00_830074b3_Tx, ComPduIdRef=EcucPduCollection/PpLightStateFront_oCAN00_7d4af1fd_Tx
          ComTxIPdu: ComTxIPduUnusedAreasDefault=0
      Veh_Door_oCAN00_Tx_2fd3c8d8 (ComIPduGroup)
      3 x ComSignal, all with ComBitPosition=0, ComBitSize=2, ComSignalEndianness=LITTLE_ENDIAN, ComSignalType=UINT8, ComTransferProperty=PENDING:
        PpLDoorState_oPpDoorStateFrontLeft_oCAN00_77696575_Tx: ComSystemTemplateSystemSignalRef=PpLDoorState
        PpLightState_oPpLightStateFront_oCAN00_830074b3_Tx: ComSystemTemplateSystemSignalRef=PpLightState
        PpRDoorState_oPpDoorStateFrontRight_oCAN00_45f6beeb_Tx: ComSystemTemplateSystemSignalRef=PpRDoorState
    ComGeneral
  module config ComM
    ComMConfigSet: ComMPncEnabled=false
      CN_CAN00_3ce10f85 (ComMChannel): ComMBusType=COMM_BUS_TYPE_CAN, ComMChannelId=0
        ComMNetworkManagement: ComMNmVariant=NONE
        CN_CAN00_6dca4e82 (ComMUserPerChannel): ComMUserChannel=CN_CAN00_aa6f78c5
      CN_CAN00_aa6f78c5 (ComMUser): ComMUserIdentifier=0
    ComMGeneral: ComMPncIdCounting=COMM_PNC_ID_COUNT_FROM_NM_MESSAGE, ComMPncSupport=false
  module config EcuC
    EcucPduCollection: PduIdTypeEnum=UINT8, PduLengthTypeEnum=UINT8
      6 x Pdu, all with PduLength=8:
        PpDoorStateFrontLeft_oCAN00_401cef01_Tx
        PpDoorStateFrontLeft_oCAN00_d010a217_Tx: SysTPduToFrameMappingRef=PpDoorStateFrontLeft
        PpDoorStateFrontRight_oCAN00_7113e5c3_Tx: SysTPduToFrameMappingRef=PpDoorStateFrontRight
        PpDoorStateFrontRight_oCAN00_c9449d55_Tx
        PpLightStateFront_oCAN00_53fe974e_Tx: SysTPduToFrameMappingRef=PpLightStateFront
        PpLightStateFront_oCAN00_7d4af1fd_Tx
  module config EcuM
    EcuMConfiguration
      EcuMCommonConfiguration
        EcuMDriverInitListOne
        EcuMDriverRestartList
        CN_CAN00_3ce10f85 (EcuMWakeupSource): EcuMWakeupSourceId=5, EcuMComMChannelRef=ComMConfigSet/CN_CAN00_3ce10f85
      EcuMFlexConfiguration: EcuMFlexModuleConfigurationRef=CanConfigSet
  module config PduR
    PduRGeneral
    PduRRoutingTables
      PduRRoutingTable
        3 x PduRRoutingPath:
          PpDoorStateFrontLeft_oCAN00_401cef01_Tx
            PpDoorStateFrontLeft_oCAN00_d010a217_Tx (PduRDestPdu): PduRDestPduRef=EcucPduCollection/PpDoorStateFrontLeft_oCAN00_d010a217_Tx
            PduRSrcPdu_b37674e5 (PduRSrcPdu): PduRSrcPduRef=EcucPduCollection/PpDoorStateFrontLeft_oCAN00_401cef01_Tx
          PpDoorStateFrontRight_oCAN00_c9449d55_Tx
            PpDoorStateFrontRight_oCAN00_7113e5c3_Tx (PduRDestPdu): PduRDestPduRef=EcucPduCollection/PpDoorStateFrontRight_oCAN00_7113e5c3_Tx
            PduRSrcPdu_1cf289f8 (PduRSrcPdu): PduRSrcPduRef=EcucPduCollection/PpDoorStateFrontRight_oCAN00_c9449d55_Tx
          PpLightStateFront_oCAN00_7d4af1fd_Tx
            PpLightStateFront_oCAN00_53fe974e_Tx (PduRDestPdu): PduRDestPduRef=EcucPduCollection/PpLightStateFront_oCAN00_53fe974e_Tx
            PduRSrcPdu_72617c45 (PduRSrcPdu): PduRSrcPduRef=EcucPduCollection/PpLightStateFront_oCAN00_7d4af1fd_Tx
