AUTOSAR XML (schema 4-2-1)
package /ActiveEcuC
  ecuc value collection ActiveEcuC: ecu-extract=SYSTEM, ecuc-values=[Com, Mcu, Rte, EcuM, Os, PduR, CanSM, Can, CanIf, Det, ComM, EcuC, BswM, vSet, Dio, NvM, Ea, Fee]
  module config Com: implementation-config-variant=VARIANT-PRE-COMPILE, module-description=Com_Impl
    ComGeneration:
      ComOutOfBoundsWriteProtectionStrategy = NONE
      ComOutOfBoundsWriteSanitizer = false
      ComOutOfBoundsReadSanitizer = false
      ComReduceConstantData2Define = false
      ComBoolDataInArrayOfStructStrategy = BOOLEAN
      ComDeduplicateIndirectedData = true
      ComDataDeduplicationStrategy = WITH_CAST
      ComReduceBoolDataByNegationThreshold = 2
      ComReduceBoolDataByNumericalComparisonThreshold = 2
      ComReduceBoolDataByNumericalRelationThreshold = 2
      ComReduceBoolDataByNumericalOperandStrategy = WITH_ANY_VALUE
      ComReduceNumericalDataByOffsetThreshold = 2
      ComReduceNumericalDataByArraySubtractionThreshold = 2
      ComReduceDataByStreaming = false
      ComShortSymbols = false
      ComInterfacesForDeactivatedData = false
      ComReferringKeysInComments = false
    ComOptimization:
      ComTxCyclicProcessingISRLockThreshold = 1
      ComTxDeadlineMonitoringISRLockThreshold = 1
      ComTxProcessingISRLockThreshold = 1
      ComRxDeadlineMonitoringISRLockThreshold = 1
      ComRxDeferredProcessingISRLockThreshold = 1
      ComGatewayProcessingISRLockThreshold = 1
      ComGatewayDescriptionProcessingISRLockThreshold = 1
      ComIPduGroupISRLockThreshold = 1
    ComConfig: ComConfigurationId=0, ComRxDeferredNotificationCacheSize=0, ComRxImmediateNotificationCacheSize=0
      ComTimeBase: ComRxTimeBase=0.01, ComTxTimeBase=0.01, ComGwTimeBase=0.01
      PpLightState_oPpLightStateFront_oCAN00_830074b3_Tx (ComSignal):
        ComBitPosition = 0
        ComBitSize = 2
        ComSignalEndianness = LITTLE_ENDIAN
        ComSignalType = UINT8
        ComTransferProperty = PENDING
        ComSignalInitValue = 0
        ComSignalAccess = ACCESS_UNCLEAR
        ComHandleId = 1
        ComSystemTemplateSystemSignalRef = PpLightState
      Veh_Door_oCAN00_Tx_2fd3c8d8 (ComIPduGroup): ComIPduGroupHandleId=0
      PpLDoorState_oPpDoorStateFrontLeft_oCAN00_77696575_Tx (ComSignal):
        ComBitPosition = 0
        ComBitSize = 2
        ComSignalEndianness = LITTLE_ENDIAN
        ComSignalType = UINT8
        ComTransferProperty = PENDING
        ComSignalInitValue = 0
        ComSignalAccess = ACCESS_UNCLEAR
        ComHandleId = 0
        ComSystemTemplateSystemSignalRef = PpLDoorState
      PpRDoorState_oPpDoorStateFrontRight_oCAN00_45f6beeb_Tx (ComSignal):
        ComBitPosition = 0
        ComBitSize = 2
        ComSignalEndianness = LITTLE_ENDIAN
        ComSignalType = UINT8
        ComTransferProperty = PENDING
        ComSignalInitValue = 0
        ComSignalAccess = ACCESS_UNCLEAR
        ComHandleId = 2
        ComSystemTemplateSystemSignalRef = PpRDoorState
      3 x ComIPdu, all with ComIPduDirection=SEND, ComIPduType=NORMAL, ComIPduSignalProcessing=DEFERRED, ComIPduCancellationSupport=false, ComIPduGroupRef=Veh_Door_oCAN00_Tx_2fd3c8d8:
        PpDoorStateFrontRight_oCAN00_c9449d55_Tx: ComIPduHandleId=1, ComIPduSignalRef=PpRDoorState_oPpDoorStateFrontRight_oCAN00_45f6beeb_Tx, ComPduIdRef=EcucPduCollection/PpDoorStateFrontRight_oCAN00_c9449d55_Tx
          ComTxIPdu: ComTxIPduUnusedAreasDefault=0, ComMinimumDelayTime=0
            ComTxModeTrue
              ComTxMode: ComTxModeMode=NONE
            ComTxModeFalse
              ComTxMode: ComTxModeMode=NONE
        PpLightStateFront_oCAN00_7d4af1fd_Tx: ComIPduHandleId=2, ComIPduSignalRef=PpLightState_oPpLightStateFront_oCAN00_830074b3_Tx, ComPduIdRef=EcucPduCollection/PpLightStateFront_oCAN00_7d4af1fd_Tx
          ComTxIPdu: ComTxIPduUnusedAreasDefault=0, ComMinimumDelayTime=0
            ComTxModeTrue
              ComTxMode: ComTxModeMode=NONE
            ComTxModeFalse
              ComTxMode: ComTxModeMode=NONE
        PpDoorStateFrontLeft_oCAN00_401cef01_Tx: ComIPduHandleId=0, ComIPduSignalRef=PpLDoorState_oPpDoorStateFrontLeft_oCAN00_77696575_Tx, ComPduIdRef=EcucPduCollection/PpDoorStateFrontLeft_oCAN00_401cef01_Tx
          ComTxIPdu: ComTxIPduUnusedAreasDefault=0, ComMinimumDelayTime=0
            ComTxModeTrue
              ComTxMode: ComTxModeMode=NONE
            ComTxModeFalse
              ComTxMode: ComTxModeMode=NONE
    ComGeneral:
      ComConfigurationUseDet = true
      ComEnableSignalGroupArrayApi = false
      ComRetryFailedTransmitRequests = true
      ComSupportedIPduGroups = 1
      ComVersionInfoApi = false
      ComAdvancedIPduCallouts = true
      ComOptimizedIPduGroupHandling = false
      ComMetaDataSupport = false
      ComReceiveSignalMacroAPI = false
      ComDeferredEventCacheSupport = false
      ComMainfunctionTimingDomainSupport = false
      ComDescriptionRoutingCodeGeneration = false
      ComSafeBswChecks = false
  module config Mcu: implementation-config-variant=VARIANT-PRE-COMPILE, module-description=Mcu_Impl
    CommonPublishedInformation:
      ArReleaseMajorVersion = 4
      ArReleaseMinorVersion = 2
      ArReleaseRevisionVersion = 2
      ModuleId = 101
      SwMajorVersion = 1
      SwMinorVersion = 0
      SwPatchVersion = 1
      VendorApiInfix = 
      VendorId = 43
    McuDebugConfiguration: McuDisableDemReportErrorStatus=false, McuGetPeriphStateApi=false, McuGetMidrStructureApi=false, McuDisableCmuApi=false, McuEnablePeripheralCMU=false
    McuModuleConfiguration:
      McuNumberOfMcuModes = 1
      McuRamSectors = 1
      McuRTCCLKINFrequencyHz = 32000
      McuRtcClkSelect = SOSCDIV1_CLK
      McuLPOClockSelect = LPO_CLK_128K
      McuLPO32KClockEnable = true
      McuLPO1KClockEnable = true
      McuClockSrcFailureNotification = ENABLED
      McuInterruptEvents: McuVoltageErrorEvent=false, McuAlternateResetEvent=false
      McuAllowedModes: McuAllowHighSpeedRunMode=false, McuAllowVeryLowPowerModes=false
      McuSIMConfig
        McuFlexTimerConfiguration:
          McuFTM3ExternalClockPinSelect = TCLK0_PIN
          McuFTM2ExternalClockPinSelect = TCLK0_PIN
          McuFTM1ExternalClockPinSelect = TCLK0_PIN
          McuFTM0ExternalClockPinSelect = TCLK0_PIN
          McuFTM7ExternalClockPinSelect = TCLK0_PIN
          McuFTM6ExternalClockPinSelect = TCLK0_PIN
          McuFTM5ExternalClockPinSelect = TCLK0_PIN
          McuFTM4ExternalClockPinSelect = TCLK0_PIN
          McuFTM3Fault{0..2}Select = FTM3_FLT{0..2}_PIN
          McuFTM2Fault{0..2}Select = FTM2_FLT{0..2}_PIN
          McuFTM1Fault{0..2}Select = FTM1_FLT{0..2}_PIN
          McuFTM0Fault{0..2}Select = FTM0_FLT{0..2}_PIN
          McuFTM3Ch{0..7}ModulationSelect = false
          McuFTM0Ch{0..7}ModulationSelect = false
          McuFTM2Ch1InputSelect = FTM2_CHI1_INPUT
          McuFTM2Ch0InputSelect = FTM2_CH0_INPUT
          McuFTM1Ch0InputSelect = FTM1_CH0_INPUT
          McuFTMGlobalLoadEnable = false
          McuFTM7SyncBit = false
          McuFTM6SyncBit = false
          McuFTM5SyncBit = false
          McuFTM4SyncBit = false
          McuFTM3SyncBit = false
          McuFTM2SyncBit = false
          McuFTM1SyncBit = false
          McuFTM0SyncBit = false
          McuQspiClkSelect = false
          McuRMII_ClkSelect = false
          McuRMII_Clk_OBE = false
          McuFTM7OBEControl = false
          McuFTM6OBEControl = false
          McuFTM5OBEControl = false
          McuFTM4OBEControl = false
          McuFTM3OBEControl = false
          McuFTM2OBEControl = false
          McuFTM1OBEControl = false
          McuFTM0OBEControl = false
          McuFTM_GTBControl = false
        McuAdcOptionsConfiguration:
          McuADC1PreTrigeerSourceSelect = PDB_PRE_TRIGGER
          McuADC1SoftwarePreTrigeerSourceSelect = SW_PRE_TRIGGER_DISABLE
          McuADC1TrigeerSourceSelect = PDB
          McuADC0PreTrigeerSourceSelect = PDB_PRE_TRIGGER
          McuADC0SoftwarePreTrigeerSourceSelect = SW_PRE_TRIGGER_DISABLE
          McuADC0TrigeerSourceSelect = PDB
          McuSoftwareTriggerToTRGMUX = false
        McuChipControlConfiguration:
          McuEnableAdcSupplyMonitoring = false
          McuAdcSupply = VDD
          McuPDBBackToBackSelect = false
          McuPTB14InterleaveChannelSelect = false
          McuPTB13InterleaveChannelSelect = false
          McuPTB1InterleaveChannelSelect = false
          McuPTB0InterleaveChannelSelect = false
      McuPowerControl:
        McuLowVoltageDetectInterruptEnable = false
        McuLowVoltageDetectResetEnable = false
        McuLowVoltageWarningInterruptEnable = false
        McuLPODisable = false
        McuClockBiasDisable = false
        McuLowPowerBiasEnable = false
        McuLpoTrimming = 0
      McuResetConfig: McuResetPinFilterBusClockSelect=0, McuResetPinFilterInStopMode=ALL_FILTERING_DISABLE, McuResetPinFilterInRunAndWait=ALL_FILTERING_DISABLE
        McuSystemInterruptEnable:
          McuResetDelayTime = DELAY_10_LPO_CYCLES
          McuStopAcknowledgeErrorInterrupt = false
          McuMDMAPSystemResetInterrupt = false
          McuSoftwareInterrupt = false
          McuCoreLockupInterrupt = false
          McuJTAGResetInterrupt = false
          McuGlobalInterrupt = false
          McuExternalResetPinInterrupt = false
          McuWatchdogInterrupt = false
          McuCMULossOfClockResetInterrupt = false
          McuLossOfLockInterrupt = false
          McuLossOfClockInterrupt = false
    McuPublishedInformation
    McuGeneralConfiguration:
      McuDevErrorDetect = false
      McuVersionInfoApi = false
      McuGetRamStateApi = false
      McuInitClock = true
      McuNoPll = false
      McuEnterLowPowerMode = true
      McuTimeout = 50000
      McuEnableUserModeSupport = false
      McuPerformResetApi = false
      McuCalloutBeforePerformReset = false
      McuPerformResetCallout = NULL_PTR
  module config Rte: implementation-config-variant=VARIANT-PRE-COMPILE, module-description=Rte_Impl
    RteInitializationBehavior: RteInitializationStrategy=RTE_INITIALIZATION_STRATEGY_AT_DATA_DECLARATION, RteSectionInitializationPolicy=INIT
    RteGeneration:
      RteGenerationMode = COMPATIBILITY_MODE
      RteIocInteractionReturnValue = RTE_IOC
      RteValueRangeCheckEnabled = false
      RteCalibrationSupport = NONE
      RteCodeVendorId = 30
      RteDevErrorDetect = false
      RteDevErrorDetectUninit = false
      RteMeasurementSupport = false
      RteOptimizationMode = MEMORY
      RteVfbTraceEnabled = false
    RteBswGeneral: RteSchMVersionInfoApi=false, RteUseComShadowSignalApi=false
    RteOsInteraction
    11 x RteBswModuleInstance:
      BswM: RteBswImplementationRef=BswM_Impl, RteBswModuleConfigurationRef=BswM
        BSWM_EXCLUSIVE_AREA_0 (RteBswExclusiveAreaImpl): RteExclusiveAreaImplMechanism=ALL_INTERRUPT_BLOCKING, RteBswExclusiveAreaRef=BSWM_EXCLUSIVE_AREA_0
        BswM_MainFunctionTimingEvent0 (RteBswEventToTaskMapping): RteBswImmediateRestart=false, RteBswEventRef=BswM_MainFunctionTimingEvent0
      Can: RteBswImplementationRef=Can_Impl, RteBswModuleConfigurationRef=Can
        3 x RteBswEventToTaskMapping, all with RteBswImmediateRestart=false:
          Can_MainFunction_BusOffTimingEvent0: RteBswEventRef=Can_MainFunction_BusOffTimingEvent0
          Can_MainFunction_WakeupTimingEvent0: RteBswEventRef=Can_MainFunction_WakeupTimingEvent0
          Can_MainFunction_ModeTimingEvent0: RteBswEventRef=Can_MainFunction_ModeTimingEvent0
        7 x RteBswExclusiveAreaImpl, all with RteExclusiveAreaImplMechanism=ALL_INTERRUPT_BLOCKING:
          CAN_EXCLUSIVE_AREA_{0..6}: RteBswExclusiveAreaRef=CAN_EXCLUSIVE_AREA_{0..6}
      CanIf: RteBswImplementationRef=CanIf_Impl, RteBswModuleConfigurationRef=CanIf
        8 x RteBswExclusiveAreaImpl, all with RteExclusiveAreaImplMechanism=ALL_INTERRUPT_BLOCKING:
          CANIF_EXCLUSIVE_AREA_{0..7}: RteBswExclusiveAreaRef=CANIF_EXCLUSIVE_AREA_{0..7}
      CanSM: RteBswImplementationRef=CanSM_Impl, RteBswModuleConfigurationRef=CanSM
        CanSM_MainFunctionTimingEvent0 (RteBswEventToTaskMapping): RteBswImmediateRestart=false, RteBswEventRef=CanSM_MainFunctionTimingEvent0
        6 x RteBswExclusiveAreaImpl, all with RteExclusiveAreaImplMechanism=ALL_INTERRUPT_BLOCKING:
          CANSM_EXCLUSIVE_AREA_{1..6}: RteBswExclusiveAreaRef=CANSM_EXCLUSIVE_AREA_{1..6}
      Com: RteBswImplementationRef=Com_Impl, RteBswModuleConfigurationRef=Com
        Com_MainFunctionTxTimingEvent0 (RteBswEventToTaskMapping): RteBswImmediateRestart=false, RteBswEventRef=Com_MainFunctionTxTimingEvent0
        Com_MainFunctionRxTimingEvent0 (RteBswEventToTaskMapping): RteBswImmediateRestart=false, RteBswEventRef=Com_MainFunctionRxTimingEvent0
        3 x RteBswExclusiveAreaImpl, all with RteExclusiveAreaImplMechanism=ALL_INTERRUPT_BLOCKING:
          COM_EXCLUSIVE_AREA_TX: RteBswExclusiveAreaRef=COM_EXCLUSIVE_AREA_TX
          COM_EXCLUSIVE_AREA_RX: RteBswExclusiveAreaRef=COM_EXCLUSIVE_AREA_RX
          COM_EXCLUSIVE_AREA_BOTH: RteBswExclusiveAreaRef=COM_EXCLUSIVE_AREA_BOTH
      ComM: RteBswImplementationRef=ComM_Impl, RteBswModuleConfigurationRef=ComM
        ComM_MainFunction_0TimingEvent0 (RteBswEventToTaskMapping): RteBswImmediateRestart=false, RteBswEventRef=ComM_MainFunction_0TimingEvent0
        COMM_EXCLUSIVE_AREA_0 (RteBswExclusiveAreaImpl): RteExclusiveAreaImplMechanism=ALL_INTERRUPT_BLOCKING, RteBswExclusiveAreaRef=COMM_EXCLUSIVE_AREA_0
        COMM_EXCLUSIVE_AREA_1 (RteBswExclusiveAreaImpl): RteExclusiveAreaImplMechanism=ALL_INTERRUPT_BLOCKING, RteBswExclusiveAreaRef=COMM_EXCLUSIVE_AREA_1
      Det: RteBswImplementationRef=Det_Impl, RteBswModuleConfigurationRef=Det
        DET_EXCLUSIVE_AREA_0 (RteBswExclusiveAreaImpl): RteExclusiveAreaImplMechanism=ALL_INTERRUPT_BLOCKING, RteBswExclusiveAreaRef=DET_EXCLUSIVE_AREA_0
      EcuM: RteBswImplementationRef=EcuM_Impl, RteBswModuleConfigurationRef=EcuM
        EcuM_MainFunctionTimingEvent0 (RteBswEventToTaskMapping): RteBswImmediateRestart=false, RteBswEventRef=EcuM_MainFunctionTimingEvent0
        3 x RteBswExclusiveAreaImpl, all with RteExclusiveAreaImplMechanism=ALL_INTERRUPT_BLOCKING:
          ECUM_EXCLUSIVE_AREA_{0..2}: RteBswExclusiveAreaRef=ECUM_EXCLUSIVE_AREA_{0..2}
      Mcu: RteBswImplementationRef=Mcu_Impl, RteBswModuleConfigurationRef=Mcu
        31 x RteBswExclusiveAreaImpl, all with RteExclusiveAreaImplMechanism=ALL_INTERRUPT_BLOCKING:
          MCU_EXCLUSIVE_AREA_{00..30}: RteBswExclusiveAreaRef=MCU_EXCLUSIVE_AREA_{00..30}
      PduR: RteBswImplementationRef=PduR_Impl, RteBswModuleConfigurationRef=PduR
        PDUR_EXCLUSIVE_AREA_0 (RteBswExclusiveAreaImpl): RteExclusiveAreaImplMechanism=ALL_INTERRUPT_BLOCKING, RteBswExclusiveAreaRef=PDUR_EXCLUSIVE_AREA_0
      Rte: RteBswImplementationRef=Rte_Impl, RteBswModuleConfigurationRef=Rte
    8 x RteSwComponentInstance:
      CpSaDoorFrontLeft_EcuSwComposition: RteSoftwareComponentInstanceRef=CpSaDoorFrontLeft
        TMT_RCtSaDoorReadDoor (RteEventToTaskMapping): RteImmediateRestart=false, RtePositionInTask=0, RteEventRef=TMT_RCtSaDoorReadDoor, RteMappedToTaskRef=IO_Task
      CpSaDoorFrontRight_EcuSwComposition: RteSoftwareComponentInstanceRef=CpSaDoorFrontRight
        TMT_RCtSaDoorReadDoor (RteEventToTaskMapping): RteImmediateRestart=false, RtePositionInTask=1, RteEventRef=TMT_RCtSaDoorReadDoor, RteMappedToTaskRef=IO_Task
      CpApMySwc_EcuSwComposition: RteSoftwareComponentInstanceRef=CpApMySwc
        4 x RteEventToTaskMapping, all with RteImmediateRestart=false:
          DRT_RCtApMySwcCode_PpDoorStateFrontLeft_DeDoorState: RtePositionInTask=0, RteEventRef=DRT_RCtApMySwcCode_PpDoorStateFrontLeft_DeDoorState, RteMappedToTaskRef=My_Task
          DRT_RCtApMySwcCode_PpDoorStateFrontRight_DeDoorState: RtePositionInTask=0, RteEventRef=DRT_RCtApMySwcCode_PpDoorStateFrontRight_DeDoorState, RteMappedToTaskRef=My_Task
          DRT_RCtApMySwcCode_PpDoorStateRearRight_DeDoorState: RteEventRef=DRT_RCtApMySwcCode_PpDoorStateRearRight_DeDoorState
          DRT_RCtApMySwcCode_PpDoorStateRearLeft_DeDoorState: RteEventRef=DRT_RCtApMySwcCode_PpDoorStateRearLeft_DeDoorState
        ExArLightOnOffCounter (RteExclusiveAreaImplementation): RteExclusiveAreaImplMechanism=ALL_INTERRUPT_BLOCKING, RteExclusiveAreaRef=ExArLightOnOffCounter
        ExArOdometer (RteExclusiveAreaImplementation): RteExclusiveAreaImplMechanism=ALL_INTERRUPT_BLOCKING, RteExclusiveAreaRef=ExArOdometer
        OIT_PpNvMNotifyJobFinishedOdometerCtApMySwc_JobFinished_PpNvMNotifyJobFinishedOdometerCtApMySwc_JobFinished (RteEventToTaskMapping):
          RteImmediateRestart = false
          RteEventRef = OIT_PpNvMNotifyJobFinishedOdometerCtApMySwc_JobFinished_PpNvMNotifyJobFinishedOdometerCtApMySwc_JobFinished
        NvmBlock_CpApMySwc_SnNvMPimLightOnOffCounter (RteNvRamAllocation): RteNvmBlockRef=CpApMySwcSnNvMPimLightOnOffCounter, RteSwNvRamMappingRef=SnNvMPimLightOnOffCounter
        NvmBlock_CpApMySwc_SnNvMPimOdometer (RteNvRamAllocation): RteNvmBlockRef=CpApMySwcSnNvMPimOdometer, RteSwNvRamMappingRef=SnNvMPimOdometer
      CpSalnteriorLight_EcuSwComposition: RteSoftwareComponentInstanceRef=CpSalnteriorLight
        DRT_RCtSaInteriorLightSwitchLight_PpLightstate_DeLightstate (RteEventToTaskMapping):
          RteImmediateRestart = false
          RtePositionInTask = 2
          RteEventRef = DRT_RCtSaInteriorLightSwitchLight_PpLightstate_DeLightstate
          RteMappedToTaskRef = IO_Task
      Det_EcuSwComposition: RteSoftwareComponentInstanceRef=Det
      BswM_EcuSwComposition: RteSoftwareComponentInstanceRef=BswM
        Timer_BswM_MainFunction (RteEventToTaskMapping): RteImmediateRestart=false, RteEventRef=Timer_BswM_MainFunction
      ComM_EcuSwComposition: RteSoftwareComponentInstanceRef=ComM
        13 x RteEventToTaskMapping, all with RteImmediateRestart=false:
          Timer_ComM_MainFunction_0: RteEventRef=Timer_ComM_MainFunction_0
          OpEventGetInhibitionStatus_GetInhibitionStatus_CL_CN_CAN00_3ce10f85: RteEventRef=OpEventGetInhibitionStatus_GetInhibitionStatus_CL_CN_CAN00_3ce10f85
          OpEventGetInhibitionStatus_GetInhibitionStatus_CW_CN_CAN00_3ce10f85: RteEventRef=OpEventGetInhibitionStatus_GetInhibitionStatus_CW_CN_CAN00_3ce10f85
          OpEventLimitECUToNoComMode_LimitECUToNoComMode_modeLimitation: RteEventRef=OpEventLimitECUToNoComMode_LimitECUToNoComMode_modeLimitation
          OpEventReadInhibitCounter_ReadInhibitCounter_modeLimitation: RteEventRef=OpEventReadInhibitCounter_ReadInhibitCounter_modeLimitation
          OpEventResetInhibitCounter_ResetInhibitCounter_modeLimitation: RteEventRef=OpEventResetInhibitCounter_ResetInhibitCounter_modeLimitation
          OpEventSetECUGroupClassification_SetECUGroupClassification_modeLimitation: RteEventRef=OpEventSetECUGroupClassification_SetECUGroupClassification_modeLimitation
          OpEventLimitChannelToNoComMode_LimitChannelToNoComMode_CL_CN_CAN00_3ce10f85: RteEventRef=OpEventLimitChannelToNoComMode_LimitChannelToNoComMode_CL_CN_CAN00_3ce10f85
          OpEventPreventWakeUp_PreventWakeUp_CW_CN_CAN00_3ce10f85: RteEventRef=OpEventPreventWakeUp_PreventWakeUp_CW_CN_CAN00_3ce10f85
          OpEventRequestComMode_RequestComMode_UR_CN_CAN00_aa6f78c5: RteEventRef=OpEventRequestComMode_RequestComMode_UR_CN_CAN00_aa6f78c5
          OpEventGetCurrentComMode_GetCurrentComMode_UR_CN_CAN00_aa6f78c5: RteEventRef=OpEventGetCurrentComMode_GetCurrentComMode_UR_CN_CAN00_aa6f78c5
          OpEventGetMaxComMode_GetMaxComMode_UR_CN_CAN00_aa6f78c5: RteEventRef=OpEventGetMaxComMode_GetMaxComMode_UR_CN_CAN00_aa6f78c5
          OpEventGetRequestedComMode_GetRequestedComMode_UR_CN_CAN00_aa6f78c5: RteEventRef=OpEventGetRequestedComMode_GetRequestedComMode_UR_CN_CAN00_aa6f78c5
      EcuM_EcuSwComposition: RteSoftwareComponentInstanceRef=EcuM
        8 x RteEventToTaskMapping, all with RteImmediateRestart=false:
          Timer_EcuM_MainFunction: RteEventRef=Timer_EcuM_MainFunction
          OpEventSelectShutdownTarget_SelectShutdownTarget_EcuM_ShutdownTarget: RteEventRef=OpEventSelectShutdownTarget_SelectShutdownTarget_EcuM_ShutdownTarget
          OpEventGetShutdownTarget_GetShutdownTarget_EcuM_ShutdownTarget: RteEventRef=OpEventGetShutdownTarget_GetShutdownTarget_EcuM_ShutdownTarget
          OpEventGetLastShutdownTarget_GetLastShutdownTarget_EcuM_ShutdownTarget: RteEventRef=OpEventGetLastShutdownTarget_GetLastShutdownTarget_EcuM_ShutdownTarget
          OpEventSelectShutdownCause_SelectShutdownCause_EcuM_ShutdownTarget: RteEventRef=OpEventSelectShutdownCause_SelectShutdownCause_EcuM_ShutdownTarget
          OpEventGetShutdownCause_GetShutdownCause_EcuM_ShutdownTarget: RteEventRef=OpEventGetShutdownCause_GetShutdownCause_EcuM_ShutdownTarget
          OpEventSelectBootTarget_SelectBootTarget_EcuM_BootTarget: RteEventRef=OpEventSelectBootTarget_SelectBootTarget_EcuM_BootTarget
          OpEventGetBootTarget_GetBootTarget_EcuM_BootTarget: RteEventRef=OpEventGetBootTarget_GetBootTarget_EcuM_BootTarget
    3 x RteSwComponentType:
      CtApMySwc: RteComponentTypeRef=CtApMySwc, RteImplementationRef=CtApMySwc_Implementation
        ComponentTypeCalibration (RteComponentTypeCalibration): RteCalibrationSupportEnabled=false
      CtSalnteriorLight: RteComponentTypeRef=CtSalnteriorLight, RteImplementationRef=CtSalnteriorLight_Implementation
        ComponentTypeCalibration (RteComponentTypeCalibration): RteCalibrationSupportEnabled=false
      CtSaDoor: RteComponentTypeRef=CtSaDoor, RteImplementationRef=CtSaDoor_Implementation
        ComponentTypeCalibration (RteComponentTypeCalibration): RteCalibrationSupportEnabled=false
    Dio (RteBswModuleInstance): RteBswImplementationRef=Dio_Impl, RteBswModuleConfigurationRef=Dio
      31 x RteBswExclusiveAreaImpl, all with RteExclusiveAreaImplMechanism=ALL_INTERRUPT_BLOCKING:
        DIO_EXCLUSIVE_AREA_{00..30}: RteBswExclusiveAreaRef=DIO_EXCLUSIVE_AREA_{00..30}
    CtCddloHwAb_EcuSwComposition (RteSwComponentInstance): RteSoftwareComponentInstanceRef=CtCddloHwAb
      3 x RteEventToTaskMapping, all with RteImmediateRestart=false:
        OIT_RCtCddloHwAb_PpDoorFrontLeft_ReadChannelPpDoorFrontLeft_ReadChannel_PpDoorFrontLeft_ReadChannel: RteEventRef=OIT_RCtCddloHwAb_PpDoorFrontLeft_ReadChannelPpDoorFrontLeft_ReadChannel_PpDoorFrontLeft_ReadChannel
        OIT_RCtCddloHwAb_PpDoorFrontRight_ReadChannelPpDoorFrontRight_ReadChannel_PpDoorFrontRight_ReadChannel: RteEventRef=OIT_RCtCddloHwAb_PpDoorFrontRight_ReadChannelPpDoorFrontRight_ReadChannel_PpDoorFrontRight_ReadChannel
        OIT_RCtCddloHwAb_PpInteriorLightFront_WriteChannelPpInteriorLightFront_WriteChannel_PpInteriorLightFront_WriteChannel: RteEventRef=OIT_RCtCddloHwAb_PpInteriorLightFront_WriteChannelPpInteriorLightFront_WriteChannel_PpInteriorLightFront_WriteChannel
    CtCddloHwAb (RteSwComponentType): RteComponentTypeRef=CtCddloHwAb, RteImplementationRef=CtCddloHwAb_Implementation
      ComponentTypeCalibration (RteComponentTypeCalibration): RteCalibrationSupportEnabled=false
    NvM (RteBswModuleInstance): RteBswImplementationRef=NvM_Impl, RteBswModuleConfigurationRef=NvM
      NvM_MainFunctionTimingEvent0 (RteBswEventToTaskMapping): RteBswImmediateRestart=false, RteBswPositionInTask=1, RteBswEventRef=NvM_MainFunctionTimingEvent0, RteBswMappedToTaskRef=My_Task
      NVM_EXCLUSIVE_AREA_0 (RteBswExclusiveAreaImpl): RteExclusiveAreaImplMechanism=ALL_INTERRUPT_BLOCKING, RteBswExclusiveAreaRef=NVM_EXCLUSIVE_AREA_0
    Ea (RteBswModuleInstance): RteBswImplementationRef=Ea_Impl, RteBswModuleConfigurationRef=Ea
      Ea_MainFunctionTimingEvent0 (RteBswEventToTaskMapping): RteBswImmediateRestart=false, RteBswEventRef=Ea_MainFunctionTimingEvent0
    NvM_EcuSwComposition (RteSwComponentInstance): RteSoftwareComponentInstanceRef=NvM
      16 x RteEventToTaskMapping, all with RteImmediateRestart=false:
        Timer_NvM_MainFunction: RtePositionInTask=1, RteEventRef=Timer_NvM_MainFunction, RteMappedToTaskRef=My_Task
        OpEventGetErrorStatus_GetErrorStatus_PS_CpApMySwcSnNvMPimLightOnOffCounter: RteEventRef=OpEventGetErrorStatus_GetErrorStatus_PS_CpApMySwcSnNvMPimLightOnOffCounter
        OpEventGetErrorStatus_GetErrorStatus_PS_CpApMySwcSnNvMPimOdometer: RteEventRef=OpEventGetErrorStatus_GetErrorStatus_PS_CpApMySwcSnNvMPimOdometer
        OpEventSetRamBlockStatus_SetRamBlockStatus_PS_CpApMySwcSnNvMPimLightOnOffCounter: RteEventRef=OpEventSetRamBlockStatus_SetRamBlockStatus_PS_CpApMySwcSnNvMPimLightOnOffCounter
        OpEventSetRamBlockStatus_SetRamBlockStatus_PS_CpApMySwcSnNvMPimOdometer: RteEventRef=OpEventSetRamBlockStatus_SetRamBlockStatus_PS_CpApMySwcSnNvMPimOdometer
        OpEventReadBlock_ReadBlock_PS_CpApMySwcSnNvMPimLightOnOffCounter: RteEventRef=OpEventReadBlock_ReadBlock_PS_CpApMySwcSnNvMPimLightOnOffCounter
        OpEventReadBlock_ReadBlock_PS_CpApMySwcSnNvMPimOdometer: RteEventRef=OpEventReadBlock_ReadBlock_PS_CpApMySwcSnNvMPimOdometer
        OpEventWriteBlock_WriteBlock_PS_CpApMySwcSnNvMPimLightOnOffCounter: RteEventRef=OpEventWriteBlock_WriteBlock_PS_CpApMySwcSnNvMPimLightOnOffCounter
        OpEventWriteBlock_WriteBlock_PS_CpApMySwcSnNvMPimOdometer: RteEventRef=OpEventWriteBlock_WriteBlock_PS_CpApMySwcSnNvMPimOdometer
        OpEventInvalidateNvBlock_InvalidateNvBlock_PS_CpApMySwcSnNvMPimLightOnOffCounter: RteEventRef=OpEventInvalidateNvBlock_InvalidateNvBlock_PS_CpApMySwcSnNvMPimLightOnOffCounter
        OpEventInvalidateNvBlock_InvalidateNvBlock_PS_CpApMySwcSnNvMPimOdometer: RteEventRef=OpEventInvalidateNvBlock_InvalidateNvBlock_PS_CpApMySwcSnNvMPimOdometer
        OpEventEraseBlock_EraseBlock_PS_CpApMySwcSnNvMPimLightOnOffCounter: RteEventRef=OpEventEraseBlock_EraseBlock_PS_CpApMySwcSnNvMPimLightOnOffCounter
        OpEventEraseBlock_EraseBlock_PS_CpApMySwcSnNvMPimOdometer: RteEventRef=OpEventEraseBlock_EraseBlock_PS_CpApMySwcSnNvMPimOdometer
        OpEventSetBlockProtection_SetBlockProtection_PAdmin_CpApMySwcSnNvMPimLightOnOffCounter: RteEventRef=OpEventSetBlockProtection_SetBlockProtection_PAdmin_CpApMySwcSnNvMPimLightOnOffCounter
        OpEventSetBlockProtection_SetBlockProtection_PAdmin_CpApMySwcSnNvMPimOdometer: RteEventRef=OpEventSetBlockProtection_SetBlockProtection_PAdmin_CpApMySwcSnNvMPimOdometer
        OpEventRestoreBlockDefaults_RestoreBlockDefaults_PS_CpApMySwcSnNvMPimOdometer: RteEventRef=OpEventRestoreBlockDefaults_RestoreBlockDefaults_PS_CpApMySwcSnNvMPimOdometer
  module config EcuM: implementation-config-variant=VARIANT-PRE-COMPILE, module-description=EcuM_Impl
    EcuMConfiguration
      EcuMFlexConfiguration: EcuMFlexModuleConfigurationRef=CanConfigSet, EcuMNormalMcuModeRef=(unset)
        ECUM_CAUSE_UNKNOWN (EcuMShutdownCause): EcuMShutdownCauseId=0
        ECUM_RESET_IO (EcuMResetMode): EcuMResetModeId=2
        ECUM_RESET_MCU (EcuMResetMode): EcuMResetModeId=0
        ECUM_CAUSE_DCM (EcuMShutdownCause): EcuMShutdownCauseId=3
        ECUM_RESET_WAKEUP (EcuMResetMode): EcuMResetModeId=3
        ECUM_CAUSE_ECU_STATE (EcuMShutdownCause): EcuMShutdownCauseId=1
        ECUM_RESET_WDG (EcuMResetMode): EcuMResetModeId=1
        ECUM_CAUSE_WDGM (EcuMShutdownCause): EcuMShutdownCauseId=2
      EcuMCommonConfiguration: EcuMConfigConsistencyHash=15989340194980705254, EcuMDefaultAppMode=(unset), EcuMOSResource=(unset)
        ECUM_WKSOURCE_POWER (EcuMWakeupSource): EcuMWakeupSourceId=0, EcuMValidationTimeout=0, EcuMCheckWakeupTimeout=0, EcuMWakeupSourcePolling=false
        EcuMDriverInitListOne
        4 x EcuMWakeupSource, all with EcuMWakeupSourcePolling=false:
          ECUM_WKSOURCE_INTERNAL_WDG: EcuMWakeupSourceId=3, EcuMValidationTimeout=0, EcuMCheckWakeupTimeout=0
          CN_CAN00_3ce10f85: EcuMWakeupSourceId=5, EcuMComMChannelRef=ComMConfigSet/CN_CAN00_3ce10f85
          ECUM_WKSOURCE_INTERNAL_RESET: EcuMWakeupSourceId=2, EcuMValidationTimeout=0, EcuMCheckWakeupTimeout=0
          ECUM_WKSOURCE_RESET: EcuMWakeupSourceId=1, EcuMValidationTimeout=0, EcuMCheckWakeupTimeout=0
        EcuMDefaultShutdownTarget: EcuMDefaultState=EcuMStateOff
        EcuMDriverRestartList
        ECUM_WKSOURCE_EXTERNAL_WDG (EcuMWakeupSource): EcuMWakeupSourceId=4, EcuMValidationTimeout=0, EcuMCheckWakeupTimeout=0, EcuMWakeupSourcePolling=false
    EcuMGeneral:
      EcuMDevErrorDetect = true
      EcuMIncludeDem = true
      EcuMIncludeDet = true
      EcuMMainFunctionPeriod = 0.01
      EcuMVersionInfoApi = false
      EcuMDeferredBswMNotification = false
      EcuMSlaveCoreHandling = true
      EcuMEnableFixBehavior = false
      EcuMNonChannelWakeupInRun = false
      EcuMGeneration: EcuMOutOfBoundsWriteSanitizer=false, EcuMOutOfBoundsReadSanitizer=false, EcuMInterfacesForDeactivatedData=false
    EcuMFlexGeneral: EcuMAlarmClockPresent=false, EcuMResetLoopDetection=false, EcuMEnableDefBehaviour=false
  module config Os: implementation-config-variant=VARIANT-PRE-COMPILE, module-description=Os_Impl
    OsPublishedInformation: OsKernelVersion=7, OsPlatformName=Arm
      S32K148 (OsDerivativeInformation):
        OsMpuAlignment = 32
        OsStackAlignment = 32
        OsExceptionVectorTableAlignment = 0
        OsInterruptVectorTableAlignment = 128
        OsHardwareManuals = NXP/Freescale - S32K14x Series Reference Manual - Supports S32K142, S32K144, S32K146, and S32K148 Document Number: S32K14XRM - Rev. 3, 03/2017
        INTC (OsSystemIntCtrl):
          OsSystemIntCtrlMaxPrios = 224
          OsSystemIntCtrlMaxSources = 240
          OsSystemIntCtrlPrioOrder = DESC
          OsSystemIntCtrlBaseAddress = 3758153728
          OsSystemIntCtrlType = NVIC
        Core0 (OsPhysicalCore):
          OsPhysicalCoreId = 0
          OsPhysicalCoreExceptionSources = 8
          OsPhysicalCoreIsAutostart = true
          OsPhysicalCoreMasterStartAllowed = false
          OsPhysicalCorePrivelegedHwAccess = true
          OsPhysicalCoreType = Cortex-M
          OsPhysicalCoreDefaultEntrySymbol = _start
          OsPhysicalCoreStackProtectionUnit = SystemMPU0
        SystemMPU0 (OsSystemMpu): OsSystemMpuBaseAddress=1073795072, OsSystemMpuId=0, OsSystemMpuMaxRegions=16, OsSystemMpuType=SYSTEM_MPU_NXP
        OsMemoryRegionDefaults_AppT (OsMemoryRegionDefaults): OsMemoryRegionDefType=APPLICATION_TRUSTED, OsMemoryRegionDefAccessRights=SUPERVISOR_RWX, OsMemoryRegionDefBusMasters=Core
        OsMemoryRegionDefaults_AppNT (OsMemoryRegionDefaults):
          OsMemoryRegionDefType = APPLICATION_NONTRUSTED
          OsMemoryRegionDefBusMasters = Core
          OsMemoryRegionDefAccessRights = USER_R
          OsMemoryRegionDefAccessRights = USER_W
        OsMemoryRegionSpecifics
          4 x OsMemoryRegionAccess:
            USER_X: OsMemoryRegionAccessRights=X, OsMemoryRegionAccessType=USER
            USER_W: OsMemoryRegionAccessRights=W, OsMemoryRegionAccessType=USER
            SUPERVISOR_RX: OsMemoryRegionAccessRights=RX, OsMemoryRegionAccessType=SUPERVISOR
            SUPERVISOR_RW: OsMemoryRegionAccessRights=RW, OsMemoryRegionAccessType=SUPERVISOR
          Debugger (OsMemoryRegionBusMaster): OsMemoryRegionBusMasterId=1
          PID_ENABLE (OsMemoryRegionFlag)
          SUPERVISOR_RWX (OsMemoryRegionAccess): OsMemoryRegionAccessRights=RWX, OsMemoryRegionAccessType=SUPERVISOR
          3 x OsMemoryRegionBusMaster:
            DMA: OsMemoryRegionBusMasterId=2
            Core: OsMemoryRegionBusMasterId=0
            ENET: OsMemoryRegionBusMasterId=3
          USER_R (OsMemoryRegionAccess): OsMemoryRegionAccessRights=R, OsMemoryRegionAccessType=USER
        SysTick (OsHardwareTimer): OsHardwareTimerBaseAddress=3758153744, OsHardwareTimerId=0, OsHardwareTimerSize=24, OsHardwareTimerUnit=PIT, OsHardwareTimerType=SysTick
          SysTick_Ch0 (OsHardwareTimerChannel): OsHardwareTimerChannelId=0, OsHardwareTimerChannelIntSource=15, OsHardwareTimerChannelOffset=0
        DEFAULT (OsInterruptSupportedType): OsInterruptSupportedTypeSeparateSources=false
    OS_APPMODE_ANY (OsAppMode)
    OSDEFAULTAPPMODE (OsAppMode)
    OsOS:
      OsGenerateMemMapForNearAddressing = false
      OsStackMonitoring = true
      OsStatus = EXTENDED
      OsUseGetServiceId = false
      OsUseParameterAccess = false
      OsUseResScheduler = false
      OsForcibleTermination = false
      OsGenerateCalloutStubs = true
      OsGenerateMemMap = COMPLETE
      OsGenerateMemMapForThreads = false
      OsServiceProtection = false
      OsStackUsageMeasurement = false
      OsUseXSignalAsyncApiCalls = false
      OsFpuUsage = NONE
      OsScalabilityClass = SC1
      OsMasterCore = (unset)
      OsSystemTimer = SystemTimer
      OsStackSummary
      OsHooks: OsErrorHook=true, OsPostTaskHook=false, OsPreTaskHook=false, OsShutdownHook=false, OsStartupHook=false
    SystemTimer (OsCounter): OsCounterMaxAllowedValue=2147483647, OsCounterMinCycle=1, OsCounterType=HARDWARE, OsSecondsPerTick=0.001, OsCounterTicksPerBase=1
      OsDriver: OsDriverHighResolution=false, OsDriverIsrRef=CounterIsr_SystemTimer, OsDriverHardwareTimerChannelRef=SysTick_Ch0
    4 x OsIsr, all with OsIsrCategory=CATEGORY_2, OsIsrInterruptType=EXTERNAL, OsIsrStackSize=1024, OsIsrEnableNesting=false, OsIsrUsesFpu=false:
      CounterIsr_SystemTimer: OsIsrInterruptPriority=32, OsIsrInterruptSource=15, OsIsrSpecialFunctionName=Os_TimerPitIsr
      CanIsr_0_BusOff: OsIsrInterruptSource=1, OsIsrInterruptPriority=0, OsIsrSpecialFunctionName=CanBusOffIsr_0  # /ActiveEcuC/Can PLAIN_TEXT CAN BusOff Interrupt. This OsIsr container has been created automatically based on the driver configuration.
      CanIsr_0_MB16To31: OsIsrInterruptSource=1, OsIsrInterruptPriority=0, OsIsrSpecialFunctionName=CanMailboxIsr_0  # /ActiveEcuC/Can PLAIN_TEXT CAN Tx and Rx Interrupt. This OsIsr container has been created automatically based on the driver configuration.
      CanIsr_0_MB00To15: OsIsrInterruptSource=1, OsIsrInterruptPriority=0, OsIsrSpecialFunctionName=CanMailboxIsr_0  # /ActiveEcuC/Can PLAIN_TEXT CAN Tx and Rx Interrupt. This OsIsr container has been created automatically based on the driver configuration.
    My_Task (OsTask): OsTaskActivation=2, OsTaskPriority=2, OsTaskSchedule=NON, OsTaskStackSharing=false, OsTaskStackSize=1024, OsTaskType=BASIC, OsTaskUsesFpu=false
    IO_Task (OsTask): OsTaskActivation=1, OsTaskPriority=3, OsTaskSchedule=NON, OsTaskStackSharing=false, OsTaskStackSize=1024, OsTaskType=EXTENDED, OsTaskUsesFpu=false
  module config PduR: implementation-config-variant=VARIANT-PRE-COMPILE, module-description=PduR_Impl
    PduRGeneral:
      PduRDevErrorDetect = true
      PduRVersionInfoApi = false
      PduRMetaDataSupport = false
      PduRPduCallback = false
      PduRSwitching = false
      PduRSafeBswChecks = false
      PduREnableDeferredTransmission = false
      PduREnableDeferredReception = false
      PduRSupportMulticore = false
      PduRGeneration:
        PduROutOfBoundsWriteProtectionStrategy = NONE
        PduROutOfBoundsWriteSanitizer = false
        PduROutOfBoundsReadSanitizer = false
        PduRNumericalDataTypeMinimizationStrategy = WITH_CAST
        PduRReduceConstantData2Define = false
        PduRBoolDataInArrayOfStructStrategy = BITMASKING
        PduRDeduplicateIndirectedData = true
        PduRDataDeduplicationStrategy = WITH_CAST
        PduRReduceBoolDataByNegationThreshold = 2
        PduRReduceBoolDataByNumericalComparisonThreshold = 2
        PduRReduceBoolDataByNumericalRelationThreshold = 2
        PduRReduceBoolDataByNumericalOperandStrategy = WITH_ANY_VALUE
        PduRReduceNumericalDataByOffsetThreshold = 2
        PduRReduceNumericalDataByArraySubtractionThreshold = 2
        PduRReduceDataByStreaming = false
        PduRShortSymbols = false
        PduRInterfacesForDeactivatedData = false
        PduRReferringKeysInComments = false
    PduRRoutingTables: PduRConfigurationId=0
      PduRRoutingTable
        3 x PduRRoutingPath, all with PduRRoutingPathCommunicationType=COMMUNICATION_INTERFACE, PduRLockRef=PduRLock_PduRExclusiveArea:
          PpDoorStateFrontLeft_oCAN00_401cef01_Tx
            PpDoorStateFrontLeft_oCAN00_d010a217_Tx (PduRDestPdu):
              PduRDestPduHandleId = 0
              PduRDestPduDirection = TRANSMIT
              PduRDestPduRoutingType = API_FORWARDING
              PduRDestPduDataProcessing = IMMEDIATE
              PduRPduLengthHandlingStrategy = UNUSED
              PduRDestPduDataProvision = PDUR_DIRECT
              PduRTransmissionConfirmation = true
              PduRDestPduRef = EcucPduCollection/PpDoorStateFrontLeft_oCAN00_d010a217_Tx
              PduRDestPduPduRBswModulesRef = PduR/CanIf
            PduRSrcPdu_b37674e5 (PduRSrcPdu):
              PduRSourcePduHandleId = 0
              PduRSrcPduDirection = TRANSMIT
              PduRSrcPduRef = EcucPduCollection/PpDoorStateFrontLeft_oCAN00_401cef01_Tx
              PduRSrcPduPduRBswModulesRef = PduR/Com
          PpDoorStateFrontRight_oCAN00_c9449d55_Tx
            PpDoorStateFrontRight_oCAN00_7113e5c3_Tx (PduRDestPdu):
              PduRDestPduHandleId = 1
              PduRDestPduDirection = TRANSMIT
              PduRDestPduRoutingType = API_FORWARDING
              PduRDestPduDataProcessing = IMMEDIATE
              PduRPduLengthHandlingStrategy = UNUSED
              PduRDestPduDataProvision = PDUR_DIRECT
              PduRTransmissionConfirmation = true
              PduRDestPduRef = EcucPduCollection/PpDoorStateFrontRight_oCAN00_7113e5c3_Tx
              PduRDestPduPduRBswModulesRef = PduR/CanIf
            PduRSrcPdu_1cf289f8 (PduRSrcPdu):
              PduRSourcePduHandleId = 1
              PduRSrcPduDirection = TRANSMIT
              PduRSrcPduRef = EcucPduCollection/PpDoorStateFrontRight_oCAN00_c9449d55_Tx
              PduRSrcPduPduRBswModulesRef = PduR/Com
          PpLightStateFront_oCAN00_7d4af1fd_Tx
            PduRSrcPdu_72617c45 (PduRSrcPdu):
              PduRSourcePduHandleId = 2
              PduRSrcPduDirection = TRANSMIT
              PduRSrcPduRef = EcucPduCollection/PpLightStateFront_oCAN00_7d4af1fd_Tx
              PduRSrcPduPduRBswModulesRef = PduR/Com
            PpLightStateFront_oCAN00_53fe974e_Tx (PduRDestPdu):
              PduRDestPduHandleId = 2
              PduRDestPduDirection = TRANSMIT
              PduRDestPduRoutingType = API_FORWARDING
              PduRDestPduDataProcessing = IMMEDIATE
              PduRPduLengthHandlingStrategy = UNUSED
              PduRDestPduDataProvision = PDUR_DIRECT
              PduRTransmissionConfirmation = true
              PduRDestPduRef = EcucPduCollection/PpLightStateFront_oCAN00_53fe974e_Tx
              PduRDestPduPduRBswModulesRef = PduR/CanIf
      PduRLock_PduRExclusiveArea (PduRLock)
        PduRExclusiveArea: PduRExclusiveAreaId=0
    CanIf (PduRBswModules):
      PduRCancelReceive = false
      PduRCancelTransmit = false
      PduRChangeParameterRequestApi = false
      PduRCommunicationInterface = true
      PduRLowerModule = true
      PduRTransportProtocol = false
      PduRTriggertransmit = false
      PduRTxConfirmation = true
      PduRUpperModule = false
      PduRUseTag = false
      PduRBswModuleRef = CanIf
    Com (PduRBswModules):
      PduRCancelReceive = false
      PduRCancelTransmit = false
      PduRChangeParameterRequestApi = false
      PduRCommunicationInterface = true
      PduRLowerModule = false
      PduRTransportProtocol = false
      PduRTriggertransmit = false
      PduRTxConfirmation = true
      PduRUpperModule = true
      PduRUseTag = false
      PduRBswModuleRef = Com
  module config CanSM: implementation-config-variant=VARIANT-PRE-COMPILE, module-description=CanSM_Impl
    CanSMConfiguration: CanSMModeRequestRepetitionMax=10, CanSMModeRequestRepetitionTime=0.1
      CHNL_0fb271d2 (CanSMManagerNetwork):
        CanSMBorCounterL1ToL2 = 5
        CanSMBorTimeL1 = 1
        CanSMBorTimeL2 = 3
        CanSMBorTimeTxEnsured = 5
        CanSMBorTxConfirmationPolling = false
        CanSMComMNetworkHandleRef = ComMConfigSet/CN_CAN00_3ce10f85
        CT_CAN00_3bdc4e64 (CanSMController): CanSMControllerId=CanIfCtrlDrvCfg_7d254554/CT_CAN00_ff4fcc05
    CanSMGeneral: CanSMDevErrorDetect=true, CanSMMainFunctionTimePeriod=0.01, CanSMVersionInfoApi=false, CanSMBorCheckLevel=false, CanSMSetBaudrateApi=false
      CanSMGeneration: CanSMOutOfBoundsWriteSanitizer=false, CanSMOutOfBoundsReadSanitizer=false
  module config Can: implementation-config-variant=VARIANT-PRE-COMPILE, module-description=Can_Impl
    CanGeneral:
      CanIndex = 0
      CanChangeBaudrateApi = false
      CanDevErrorDetection = true
      CanHardwareCancellation = false
      CanIdenticalIdCancellation = false
      CanMainFunctionBusoffPeriod = 0.01
      CanMainFunctionModePeriod = 0.01
      CanMainFunctionWakeupPeriod = 0.01
      CanMultiplexedTransmission = false
      CanSetBaudrateApi = false
      CanTimeoutDuration = 0.01
      CanVersionInfoApi = false
      CanGenericPrecopy = false
      CanHardwareLoopCheck = true
      CanSecureTempBuffer = false
      CanRxFullCANSupport = false
      CanTxFullCANSupport = false
      CanRxBasicCANSupport = true
      CanUseNestedCANInterrupts = false
      CanHardwareCancelByAppl = false
      CanIndividualProcessing = false
      CanGenericConfirmation = false
      CanRxQueue = false
      CanSupportMixedID = false
      CanRxQueueSize = 10
      CanMultipleBasicCANObjects = false
      CanMultipleBasicCANTxObjects = false
      CanHardwareHandleType = UINT8
      CanOptimizeOneController = true
      CanInterruptCategory = CATEGORY2
      CanGetStatus = false
      CanInterruptLock = DRIVER
      CanWakeupSupport = false
      CanRamCheck = None
      CanOverrunNotification = DET
      CanReinitStart = false
      CanGenericPreTransmit = false
      CanFdSupport = NONE
      CanRuntimeMeasurementSupport = false
      CanMaxRxDataLen = 8
      CanMaxTxDataLen = 8
      CanUsePeripheralAccessApi = false
      CanMirrorModeSupport = false
      CanWorkaroundERR005829Enable = false
      CanTASDEnable = false
      CanSleepModeSelection = DISABLE_MODE
      CanEnableGlitchFilter = false
      CanCoreSelection = Cortex_A9
      CanSafeBswChecks = false
      CanUseOsInterruptControl = true
      CanSilentModeSupport = false
      CanCounterRef = (unset)
      CanMainFunctionRWPeriods
    CanConfigSet
      CN_CAN00_3ce10f85_Tx (CanHardwareObject):
        CanHandleType = BASIC
        CanIdValue = 0
        CanObjectType = TRANSMIT
        CanIdType = STANDARD
        CanObjectId = 0
        CanHwProcessing = false
        CanObjectHwSize = 1
        CanObjectHwHandle = 8
        CanMaxDataLen = 8
        CanFdPaddingValue = 0
        CanObjectMultiplexedTransmission = false
        CanControllerRef = CanConfigSet/CT_CAN00_ff4fcc05
      CT_CAN00_ff4fcc05 (CanController):
        CanControllerActivation = true
        CanBusoffProcessing = INTERRUPT
        CanControllerBaseAddress = 1073889280
        CanControllerId = 0
        CanRxProcessing = INTERRUPT
        CanTxProcessing = INTERRUPT
        CanWakeupProcessing = INTERRUPT
        CanWakeupSupport = false
        CanWakeupSourceId = 0
        CanBaseAddress = FlexCAN_0
        CanChannelGlitchFilter = 127
        CanControllerDefaultBaudrate = CanControllerBaudrateConfig
        CanControllerSystemRef = CT_CAN00
        CanWakeupSourceRef = EcuMCommonConfiguration/CN_CAN00_3ce10f85
        CanCpuClockRef = (unset)
        CanControllerBaudrateConfig:
          CanControllerBaudRate = 500
          CanControllerBaudRateConfigID = 0
          CanControllerPropSeg = 5
          CanControllerSeg1 = 2
          CanControllerSeg2 = 2
          CanControllerSyncJumpWidth = 1
          CanBaudrateClock = 1
          CanBaudratePrescaler = 2
          CanSamplingMode = OneSample
          CanClockSelection = OscillatorClock
          CanTASDValue = 16
        CanFilterMask: CanFilterMaskValue=0, CanFilterCodeValue=0, IsLocked=false
      CanHardwareObject:
        CanHandleType = BASIC
        CanIdType = STANDARD
        CanIdValue = 0
        CanObjectId = 1
        CanObjectType = RECEIVE
        CanHwProcessing = false
        CanObjectHwSize = 1
        CanObjectHwHandle = 0
        CanMaxDataLen = 8
        CanFdPaddingValue = 0
        CanObjectMultiplexedTransmission = false
        CanControllerRef = CanConfigSet/CT_CAN00_ff4fcc05
        CanFilterMaskRef = CanFilterMask
  module config CanIf: implementation-config-variant=VARIANT-PRE-COMPILE, module-description=CanIf_Impl
    CanIfCtrlDrvCfg_7d254554 (CanIfCtrlDrvCfg): CanIfCtrlDrvTxCancellation=false, CanIfCtrlDrvInitHohConfigRef=CanIfInitHohCfg, CanIfCtrlDrvNameRef=CanGeneral
      CT_CAN00_ff4fcc05 (CanIfCtrlCfg): CanIfCtrlId=0, CanIfCtrlWakeupSupport=false, CanIfCtrlJ1939DynAddrSupport=DISABLED, CanIfCtrlCanCtrlRef=CanConfigSet/CT_CAN00_ff4fcc05
    CanIfDispatchCfg:
      CanIfDispatchUserCtrlBusOffName = CanSM_ControllerBusOff
      CanIfDispatchUserCtrlBusOffUL = CAN_SM
      CanIfDispatchUserCtrlModeIndicationName = CanSM_ControllerModeIndication
      CanIfDispatchUserCtrlModeIndicationUL = CAN_SM
    CanIfInitCfg
      PpLightStateFront_oCAN00_b1ad26f2_Tx (CanIfTxPduCfg):
        CanIfTxPduCanId = 291
        CanIfTxPduCanIdType = STANDARD_CAN
        CanIfTxPduDlc = 8
        CanIfTxPduUserTxConfirmationName = PduR_CanIfTxConfirmation
        CanIfTxPduUserTxConfirmationUL = PDUR
        CanIfTxPduId = 2
        CanIfTxPduReadNotifyStatus = false
        CanIfTxPduType = STATIC
        CanIfTxPduBufferRef = CanIfInitCfg/CHNL_0fb271d2
        CanIfTxPduRef = EcucPduCollection/PpLightStateFront_oCAN00_53fe974e_Tx
      CHNL_0fb271d2 (CanIfBufferCfg):
        CanIfBufferSize = 3
        CanIfTxBufferHandlingType = PRIO_BY_CANID
        CanIfTxBufferMappedTxPdus = 3
        CanIfTxBufferMaxPduLength = 8
        CanIfBufferHthRef = CanIfInitHohCfg/CN_CAN00_3ce10f85_Tx
      CanIfInitHohCfg: CanIfInitRefCfgSet=CanConfigSet
        CN_CAN00_3ce10f85_Tx (CanIfHthCfg): CanIfHthCanCtrlIdRef=CanIfCtrlDrvCfg_7d254554/CT_CAN00_ff4fcc05, CanIfHthIdSymRef=CanConfigSet/CN_CAN00_3ce10f85_Tx
        CanIfHrhCfg: CanIfHrhSoftwareFilter=true, CanIfHrhCanCtrlIdRef=CanIfCtrlDrvCfg_7d254554/CT_CAN00_ff4fcc05, CanIfHrhIdSymRef=CanHardwareObject
      PpDoorStateFrontRight_oCAN00_c931c05d_Tx (CanIfTxPduCfg):
        CanIfTxPduCanId = 292
        CanIfTxPduCanIdType = STANDARD_CAN
        CanIfTxPduDlc = 8
        CanIfTxPduUserTxConfirmationName = PduR_CanIfTxConfirmation
        CanIfTxPduUserTxConfirmationUL = PDUR
        CanIfTxPduId = 1
        CanIfTxPduReadNotifyStatus = false
        CanIfTxPduType = STATIC
        CanIfTxPduBufferRef = CanIfInitCfg/CHNL_0fb271d2
        CanIfTxPduRef = EcucPduCollection/PpDoorStateFrontRight_oCAN00_7113e5c3_Tx
      PpDoorStateFrontLeft_oCAN00_2cd6f4bb_Tx (CanIfTxPduCfg):
        CanIfTxPduCanId = 293
        CanIfTxPduCanIdType = STANDARD_CAN
        CanIfTxPduDlc = 8
        CanIfTxPduUserTxConfirmationName = PduR_CanIfTxConfirmation
        CanIfTxPduUserTxConfirmationUL = PDUR
        CanIfTxPduId = 0
        CanIfTxPduReadNotifyStatus = false
        CanIfTxPduType = STATIC
        CanIfTxPduBufferRef = CanIfInitCfg/CHNL_0fb271d2
        CanIfTxPduRef = EcucPduCollection/PpDoorStateFrontLeft_oCAN00_d010a217_Tx
    CanIfPrivateCfg:
      CanIfPrivateSoftwareFilterType = LINEAR
      CanIfPrivateDlcCheck = false
      CanIfSupportTTCAN = false
      CanIfTransceiverMapping = false
      CanIfTransceiverHandling = false
      CanIfSupportExtendedIds = false
      CanIfSupportNmOsek = false
      CanIfTxBufferType = BYTE_QUEUE
      CanIfOptimizeOneController = true
      CanIfWakeupSupport = false
      CanIfStaticFdTxBufferSupport = false
      CanIfRxSearchConsiderMsgType = false
      CanIfMultipleBasicCANTxObjects = false
      CanIfTxBufferFifoSupport = false
      CanIfSetPduReceptionModeSupport = false
      CanIfDataChecksumRxSupport = false
      CanIfDataChecksumTxSupport = false
    CanIfPublicCfg:
      CanIfPublicPnSupport = false
      CanIfPublicCancelTransmitSupport = false
      CanIfPublicDevErrorDetect = true
      CanIfPublicHandleTypeEnum = UINT8
      CanIfPublicMultipleDrvSupport = false
      CanIfPublicNumberOfCanHwUnits = 1
      CanIfPublicReadRxPduDataApi = false
      CanIfPublicReadRxPduNotifyStatusApi = false
      CanIfPublicReadTxPduNotifyStatusApi = false
      CanIfPublicSetDynamicTxIdApi = false
      CanIfPublicTxBuffering = true
      CanIfPublicTxConfirmPollingSupport = false
      CanIfPublicVersionInfoApi = false
      CanIfPublicWakeupCheckValidSupport = false
      CanIfPnWakeupTxPduFilterSupport = false
      CanIfPnTrcvHandlingSupport = false
      CanIfJ1939DynAddrSupport = DISABLED
      CanIfSafeBswChecks = false
      CanIfSetBaudrateApi = false
  module config Det: implementation-config-variant=VARIANT-PRE-COMPILE, module-description=Det_Impl
    DetGeneral:
      DetVersionInfoApi = false
      DetEnableDet = true
      DetExtDebugSupport = false
      DetGlobalFilterSize = 0
      DetBreakFilterSize = 0
      DetLogBufferSize = 0
      DetReportErrorRecursionLimit = 0
      DetReportRuntimeErrorRecursionLimit = 0
      DetReportTransientFaultRecursionLimit = 0
      DetDltFilterSize = 0
  module config ComM: implementation-config-variant=VARIANT-PRE-COMPILE, module-description=ComM_Impl
    ComMGeneral:
      ComMPncIdCounting = COMM_PNC_ID_COUNT_FROM_NM_MESSAGE
      ComMPncSupport = false
      ComMDevErrorDetect = true
      ComMEcuGroupClassification = 3
      ComMModeLimitationEnabled = false
      ComMSynchronousWakeUp = true
      ComMTMinFullComModeDuration = 5
      ComMVersionInfoApi = false
      ComMWakeupInhibitionEnabled = false
      ComMSafeBswChecks = false
      ComMGeneration: ComMOutOfBoundsWriteSanitizer=false, ComMOutOfBoundsReadSanitizer=false
    ComMConfigSet: ComMPncEnabled=false
      CN_CAN00_aa6f78c5 (ComMUser): ComMUserIdentifier=0, ComMUserModeNotification=false
      CN_CAN00_3ce10f85 (ComMChannel):
        ComMBusType = COMM_BUS_TYPE_CAN
        ComMChannelId = 0
        ComMFullCommRequestNotificationEnabled = false
        ComMMainFunctionPeriod = 0.02
        ComMNoCom = false
        ComMNoWakeup = false
        ComMNetworkManagement: ComMNmVariant=NONE, ComMPncNmRequest=false
        CN_CAN00_6dca4e82 (ComMUserPerChannel): ComMUserChannel=CN_CAN00_aa6f78c5
  module config EcuC: implementation-config-variant=VARIANT-PRE-COMPILE, module-description=EcuC_Impl
    EcucPduCollection: PduIdTypeEnum=UINT8, PduLengthTypeEnum=UINT8
      6 x Pdu, all with PduLength=8, J1939Requestable=false:
        PpLightStateFront_oCAN00_7d4af1fd_Tx
        PpDoorStateFrontRight_oCAN00_7113e5c3_Tx: SysTPduToFrameMappingRef=PpDoorStateFrontRight
        PpDoorStateFrontRight_oCAN00_c9449d55_Tx
        PpLightStateFront_oCAN00_53fe974e_Tx: SysTPduToFrameMappingRef=PpLightStateFront
        PpDoorStateFrontLeft_oCAN00_401cef01_Tx
        PpDoorStateFrontLeft_oCAN00_d010a217_Tx: SysTPduToFrameMappingRef=PpDoorStateFrontLeft
    EcucGeneral:
      CPUType = CPU32Bit
      SizeOfInt = Size32Bit
      ByteOrder = LITTLE_ENDIAN
      BitOrder = LSB_to_MSB
      AtomicBitAccessInBitfield = false
      AtomicVariableAccess = Atomic32BitAccess
      SizeOfEnum = Size32Bit
      SizeOfROMPointer = Size32Bit
      SizeOfRAMPointer = Size32Bit
      BitFieldDataType = INT
      StructAlignment = Auto
      ArrayAlignment = Auto
      StructInArrayAlignment = Auto
      DummyFunction = false
      EcuCSafeBswChecks = false
      DummyStatement = true
      DummyStatementKind = SelfAssignment
      ConditionalGenerating = true
      EcucBswImplementationCodeType = EcuCSourceCode
      EcuCUseStdReturnTypeForRte = false
      BswInitialization
        22 x InitFunction:
          BswM_Init: Header=BswM.h, InitPhase=NO_INIT, ConfigType=BswM_ConfigType, ConfigPtrName=BswM_Config_Ptr, ConfigPtrClass=BSWM_INIT_DATA, ModuleRef=BswM
          BswM_InitMemory: Header=BswM.h, InitPhase=INIT_MEMORY, ModuleRef=BswM
          CanIf_InitMemory: Header=CanIf.h, InitPhase=INIT_MEMORY, ModuleRef=CanIf
          CanIf_Init: Header=CanIf.h, InitPhase=INIT_TWO_IF, ConfigType=CanIf_ConfigType, ConfigPtrName=CanIf_Config_Ptr, ConfigPtrClass=CANIF_INIT_DATA, ModuleRef=CanIf
          CanSM_Init: Header=CanSM_EcuM.h, InitPhase=INIT_TWO_SM, ConfigType=CanSM_ConfigType, ConfigPtrName=CanSM_Config_Ptr, ConfigPtrClass=CANSM_INIT_DATA, ModuleRef=CanSM
          CanSM_InitMemory: Header=CanSM_EcuM.h, InitPhase=INIT_MEMORY, ModuleRef=CanSM
          Can_Init: Header=Can.h, InitPhase=INIT_TWO_DRV, ConfigType=Can_ConfigType, ConfigPtrName=Can_Config_Ptr, ConfigPtrClass=CAN_INIT_DATA, ModuleRef=Can
          Can_InitMemory: Header=Can.h, InitPhase=INIT_MEMORY, ModuleRef=Can
          ComM_InitMemory: Header=ComM.h, InitPhase=INIT_MEMORY, ModuleRef=ComM
          ComM_Init: Header=ComM.h, InitPhase=INIT_TWO_POST_NVMREADALL, ModuleRef=ComM
          Com_Init: Header=Com.h, InitPhase=INIT_TWO_COM, ConfigType=Com_ConfigType, ConfigPtrName=Com_Config_Ptr, ConfigPtrClass=COM_INIT_DATA, ModuleRef=Com
          Com_InitMemory: Header=Com.h, InitPhase=INIT_MEMORY, ModuleRef=Com
          Det_InitMemory: Header=Det.h, InitPhase=INIT_MEMORY, ModuleRef=Det
          Det_Init: Header=Det.h, InitPhase=INIT_ZERO, ConfigType=Det_ConfigType, ConfigPtrName=Det_Config_Ptr, ConfigPtrClass=DET_INIT_DATA, ModuleRef=Det
          EcuM_Init: Header=EcuM.h, InitPhase=NO_INIT, ConfigType=EcuM_PbConfigType, ConfigPtrName=EcuM_Config_Ptr, ConfigPtrClass=ECUM_INIT_DATA, ModuleRef=EcuM
          Mcu_Init: Header=Mcu.h, InitPhase=INIT_ONE_EARLY, ConfigType=Mcu_ConfigType, ConfigPtrName=NULL_PTR, ConfigPtrClass=MCU_APPL_CONST, AdditionalInitCode=Mcu_InitClock(McuConf_McuClockSettingConfig_McuClockSettingConfig_0); while (MCU_PLL_LOCKED != Mcu_GetPllStatus()); Mcu_DistributePllClock();, ModuleRef=Mcu
          PduR_InitMemory: Header=PduR.h, InitPhase=INIT_MEMORY, ModuleRef=PduR
          PduR_Init: Header=PduR.h, InitPhase=INIT_TWO_COM, ConfigType=PduR_PBConfigType, ConfigPtrName=PduR_Config_Ptr, ConfigPtrClass=PDUR_INIT_DATA, ModuleRef=PduR
          SchM_Init: Header=Rte_Main.h, InitPhase=NO_INIT, ModuleRef=Rte
          Rte_InitMemory: Header=Rte_Main.h, InitPhase=INIT_MEMORY, ModuleRef=Rte
          NvM_Init: Header=NvM.h, InitPhase=INIT_TWO_SYS, ModuleRef=NvM
          Ea_Init: Header=Ea.h, InitPhase=INIT_TWO_IF, ModuleRef=Ea
  module config BswM: implementation-config-variant=VARIANT-PRE-COMPILE, module-description=BswM_Impl
    BswMGeneral:
      BswMCanSMEnabled = true
      BswMComMEnabled = true
      BswMDcmEnabled = false
      BswMDevErrorDetect = true
      BswMEcuMEnabled = true
      BswMEthIfEnabled = false
      BswMEthSMEnabled = false
      BswMFrSMEnabled = false
      BswMGenericRequestEnabled = true
      BswMJ1939DcmEnabled = false
      BswMJ1939NmEnabled = false
      BswMLinSMEnabled = false
      BswMLinTPEnabled = false
      BswMNmEnabled = false
      BswMNvMEnabled = true
      BswMPduREnabled = false
      BswMRuleControlEnabled = false
      BswMSdEnabled = false
      BswMVersionInfoApi = false
      BswMWdgMEnabled = false
      BswMModeCheck = true
      BswMActionListQueueSearchAlgorithm = LINEAR_SEARCH
      BswMMainFunctionPeriod = 0.01
      BswMCommonData
      BswMGeneration:
        BswMOutOfBoundsWriteSanitizer = false
        BswMOutOfBoundsReadSanitizer = false
        BswMReduceConstantData2Define = true
        BswMReduceDataByStreaming = false
        BswMBoolDataInArrayOfStructStrategy = BITMASKING
        BswMInterfacesForDeactivatedData = false
    BswMConfig
      BswMArbitration
        ESH_RunToPostRun (BswMRule):
          BswMNestedExecutionOnly = false
          BswMRuleId = 6
          BswMRuleInitState = BSWM_FALSE
          BswMRuleExpressionRef = ESH_LE_RunToPostRunTransition
          BswMRuleTrueActionList = ESH_AL_ExitRun
        ESH_LE_RunToPostRunTransition (BswMLogicalExpression): BswMLogicalOperator=BSWM_AND, BswMArgumentRef=ESH_LE_RunReached, BswMArgumentRef=ESH_LE_NoRunAndNoKillAllRequest
        ESH_LE_RunReached (BswMLogicalExpression): BswMLogicalOperator=BSWM_AND, BswMArgumentRef=ESH_Cond_StateIsRun, BswMArgumentRef=ESH_Cond_ModeIsRun
        ESH_Cond_StateIsRun (BswMModeCondition): BswMConditionType=BSWM_EQUALS, BswMConditionMode=ESH_State
          BswMConditionValue
            BswMBswMode: BswMBswRequestedMode=ESH_RUN
        ESH_State (BswMModeRequestPort): BswMArbitrateOnInit=true, BswMRequestProcessing=BSWM_IMMEDIATE
          BswMModeRequestSource
            BswMGenericRequest: BswMModeRequesterId=230, BswMRequestedModeMax=7
              7 x BswMGenericRequestMode:
                ESH_INIT: BswMGenericRequestModeValue=0
                ESH_RUN: BswMGenericRequestModeValue=1
                ESH_POST_RUN: BswMGenericRequestModeValue=2
                ESH_PREP_SHUTDOWN: BswMGenericRequestModeValue=3
                ESH_WAIT_FOR_NVM: BswMGenericRequestModeValue=4
                ESH_SHUTDOWN: BswMGenericRequestModeValue=5
                ESH_WAKEUP: BswMGenericRequestModeValue=6
          BswMModeInitValue
            BswMBswModeInitValue: BswMBswModeInitValueMode=ESH_INIT
        ESH_Cond_ModeIsRun (BswMModeCondition): BswMConditionType=BSWM_EQUALS, BswMConditionMode=ESH_ModeNotification
          BswMConditionValue
            BswMModeDeclaration: BswMModeValueRef=RUN
        ESH_ModeNotification (BswMModeRequestPort): BswMArbitrateOnInit=false, BswMRequestProcessing=BSWM_DEFERRED
          BswMModeRequestSource
            BswMSwcModeNotification: BswMSwcModeNotificationModeDeclarationGroupPrototypeRef=BswM_MDGP_ESH_Mode
          BswMModeInitValue
            BswMSwcModeInitValue: BswMSwcModeInitValueRef=STARTUP
        3 x BswMLogicalExpression:
          ESH_LE_NoRunAndNoKillAllRequest: BswMLogicalOperator=BSWM_OR, BswMArgumentRef=ESH_LE_NoRunReasons
          ESH_LE_NoRunReasons: BswMLogicalOperator=BSWM_AND, BswMArgumentRef=ESH_LE_AllChannelsNoCom, BswMArgumentRef=ESH_LE_RunReleased, BswMArgumentRef=ESH_Cond_SelfRunReqTimerExpired
          ESH_LE_AllChannelsNoCom: BswMLogicalOperator=BSWM_AND, BswMArgumentRef=ESH_Cond_NoComOn_CN_CAN00_3ce10f85
        ESH_Cond_NoComOn_CN_CAN00_3ce10f85 (BswMModeCondition): BswMConditionType=BSWM_EQUALS, BswMConditionMode=ESH_ComMIndication_CN_CAN00_3ce10f85
          BswMConditionValue
            BswMBswMode: BswMBswRequestedMode=COMM_NO_COMMUNICATION
        ESH_ComMIndication_CN_CAN00_3ce10f85 (BswMModeRequestPort): BswMArbitrateOnInit=false, BswMRequestProcessing=BSWM_DEFERRED
          BswMModeRequestSource
            BswMComMIndication: BswMComMChannelRef=ComMConfigSet/CN_CAN00_3ce10f85
          BswMModeInitValue
            BswMBswModeInitValue: BswMBswModeInitValueMode=COMM_NO_COMMUNICATION
        ESH_LE_RunReleased (BswMLogicalExpression): BswMLogicalOperator=BSWM_AND, BswMArgumentRef=ESH_Cond_RunRequest0IsReleased, BswMArgumentRef=ESH_Cond_RunRequest1IsReleased
        ESH_Cond_RunRequest0IsReleased (BswMModeCondition): BswMConditionType=BSWM_EQUALS, BswMConditionMode=ESH_RunRequest_0
          BswMConditionValue
            BswMModeDeclaration: BswMModeValueRef=RELEASED
        ESH_RunRequest_0 (BswMModeRequestPort): BswMArbitrateOnInit=false, BswMRequestProcessing=BSWM_DEFERRED
          BswMModeRequestSource
            BswMSwcModeRequest: BswMModeRequestDataElementPrototypeName=requestedMode, BswMSwcModeRequestModeDeclarationGroupPrototypeRef=BswM_MDGP_ESH_RunRequest
          BswMModeInitValue
            BswMSwcModeInitValue: BswMSwcModeInitValueRef=RELEASED
        ESH_Cond_RunRequest1IsReleased (BswMModeCondition): BswMConditionType=BSWM_EQUALS, BswMConditionMode=ESH_RunRequest_1
          BswMConditionValue
            BswMModeDeclaration: BswMModeValueRef=RELEASED
        ESH_RunRequest_1 (BswMModeRequestPort): BswMArbitrateOnInit=false, BswMRequestProcessing=BSWM_DEFERRED
          BswMModeRequestSource
            BswMSwcModeRequest: BswMModeRequestDataElementPrototypeName=requestedMode, BswMSwcModeRequestModeDeclarationGroupPrototypeRef=BswM_MDGP_ESH_RunRequest
          BswMModeInitValue
            BswMSwcModeInitValue: BswMSwcModeInitValueRef=RELEASED
        ESH_Cond_SelfRunReqTimerExpired (BswMModeCondition): BswMConditionType=BSWM_EQUALS, BswMConditionMode=ESH_SelfRunRequestTimer
          BswMConditionValue
            BswMBswMode: BswMBswRequestedMode=BSWM_TIMER_EXPIRED
        ESH_SelfRunRequestTimer (BswMModeRequestPort): BswMArbitrateOnInit=false, BswMRequestProcessing=BSWM_DEFERRED
          BswMModeRequestSource
            BswMTimer
          BswMModeInitValue
            BswMBswModeInitValue: BswMBswModeInitValueMode=BSWM_TIMER_STOPPED
        ESH_RunToPostRunNested (BswMRule):
          BswMNestedExecutionOnly = true
          BswMRuleId = 7
          BswMRuleInitState = BSWM_FALSE
          BswMRuleExpressionRef = ESH_LE_ComMNoPendingRequests
          BswMRuleTrueActionList = ESH_AL_RunToPostRun
        ESH_LE_ComMNoPendingRequests (BswMLogicalExpression): BswMLogicalOperator=BSWM_OR, BswMArgumentRef=ESH_Cond_ComMNoPendingRequests
        ESH_Cond_ComMNoPendingRequests (BswMModeCondition): BswMConditionType=BSWM_EQUALS, BswMConditionMode=ESH_ComMPendingRequests
          BswMConditionValue
            BswMBswMode: BswMBswRequestedMode=ESH_COMM_NO_REQUEST
        ESH_ComMPendingRequests (BswMModeRequestPort): BswMArbitrateOnInit=false, BswMRequestProcessing=BSWM_DEFERRED
          BswMModeRequestSource
            BswMGenericRequest: BswMModeRequesterId=232, BswMRequestedModeMax=2
              ESH_COMM_NO_REQUEST (BswMGenericRequestMode): BswMGenericRequestModeValue=0
              ESH_COMM_PENDING_REQUEST (BswMGenericRequestMode): BswMGenericRequestModeValue=1
          BswMModeInitValue
            BswMBswModeInitValue: BswMBswModeInitValueMode=ESH_COMM_NO_REQUEST
        ESH_WaitToShutdown (BswMRule):
          BswMNestedExecutionOnly = false
          BswMRuleId = 8
          BswMRuleInitState = BSWM_FALSE
          BswMRuleExpressionRef = ESH_LE_WaitForNvMToShutdown
          BswMRuleTrueActionList = ESH_AL_WaitForNvMToShutdown
        ESH_LE_WaitForNvMToShutdown (BswMLogicalExpression): BswMLogicalOperator=BSWM_AND, BswMArgumentRef=ESH_Cond_StateIsWaitForNvm, BswMArgumentRef=ESH_LE_NoWakeupOrKillAll
        ESH_Cond_StateIsWaitForNvm (BswMModeCondition): BswMConditionType=BSWM_EQUALS, BswMConditionMode=ESH_State
          BswMConditionValue
            BswMBswMode: BswMBswRequestedMode=ESH_WAIT_FOR_NVM
        ESH_LE_NoWakeupOrKillAll (BswMLogicalExpression): BswMLogicalOperator=BSWM_OR, BswMArgumentRef=ESH_LE_NoWakeup
        ESH_LE_NoWakeup (BswMLogicalExpression): BswMLogicalOperator=BSWM_AND, BswMArgumentRef=ESH_Cond_NoValidatedWakeups, BswMArgumentRef=ESH_Cond_ComMNoPendingRequests
        ESH_Cond_NoValidatedWakeups (BswMModeCondition): BswMConditionType=BSWM_EQUALS, BswMConditionMode=ESH_EcuM_GetValidatedWakeupEvents
          BswMConditionValue
            BswMBswMode: BswMBswRequestedMode=0
        ESH_EcuM_GetValidatedWakeupEvents (BswMModeRequestPort): BswMArbitrateOnInit=false, BswMRequestProcessing=BSWM_DEFERRED
          BswMModeRequestSource
            BswMUserConditionRequest: BswMUserCondition=EcuM_GetValidatedWakeupEvents()
        ESH_WakeupToPrep (BswMRule):
          BswMNestedExecutionOnly = false
          BswMRuleId = 10
          BswMRuleInitState = BSWM_FALSE
          BswMRuleExpressionRef = ESH_LE_WakeupToPrepShutdown
          BswMRuleTrueActionList = ESH_AL_WakeupToPrep
        ESH_LE_WakeupToPrepShutdown (BswMLogicalExpression):
          BswMLogicalOperator = BSWM_AND
          BswMArgumentRef = ESH_Cond_StateIsWakeup
          BswMArgumentRef = ESH_Cond_NoPendingWakeups
          BswMArgumentRef = ESH_LE_NoWakeup
          BswMArgumentRef = ESH_Cond_ModeIsWakeup
        ESH_Cond_StateIsWakeup (BswMModeCondition): BswMConditionType=BSWM_EQUALS, BswMConditionMode=ESH_State
          BswMConditionValue
            BswMBswMode: BswMBswRequestedMode=ESH_WAKEUP
        ESH_Cond_NoPendingWakeups (BswMModeCondition): BswMConditionType=BSWM_EQUALS, BswMConditionMode=ESH_EcuM_GetPendingWakeupEvents
          BswMConditionValue
            BswMBswMode: BswMBswRequestedMode=0
        ESH_EcuM_GetPendingWakeupEvents (BswMModeRequestPort): BswMArbitrateOnInit=false, BswMRequestProcessing=BSWM_DEFERRED
          BswMModeRequestSource
            BswMUserConditionRequest: BswMUserCondition=EcuM_GetPendingWakeupEvents()
        ESH_Cond_ModeIsWakeup (BswMModeCondition): BswMConditionType=BSWM_EQUALS, BswMConditionMode=ESH_ModeNotification
          BswMConditionValue
            BswMModeDeclaration: BswMModeValueRef=WAKEUP
        ESH_WaitToWakeup (BswMRule):
          BswMNestedExecutionOnly = false
          BswMRuleId = 9
          BswMRuleInitState = BSWM_FALSE
          BswMRuleExpressionRef = ESH_LE_WaitForNvMToWakeup
          BswMRuleTrueActionList = ESH_AL_WaitForNvMWakeup
        ESH_LE_WaitForNvMToWakeup (BswMLogicalExpression): BswMLogicalOperator=BSWM_AND, BswMArgumentRef=ESH_Cond_StateIsWaitForNvm, BswMArgumentRef=ESH_LE_ValidWakeup
        ESH_LE_ValidWakeup (BswMLogicalExpression): BswMLogicalOperator=BSWM_OR, BswMArgumentRef=ESH_Cond_ValidatedWakeups, BswMArgumentRef=ESH_Cond_ComMPendingRequests
        ESH_Cond_ValidatedWakeups (BswMModeCondition): BswMConditionType=BSWM_EQUALS_NOT, BswMConditionMode=ESH_EcuM_GetValidatedWakeupEvents
          BswMConditionValue
            BswMBswMode: BswMBswRequestedMode=0
        ESH_Cond_ComMPendingRequests (BswMModeCondition): BswMConditionType=BSWM_EQUALS, BswMConditionMode=ESH_ComMPendingRequests
          BswMConditionValue
            BswMBswMode: BswMBswRequestedMode=ESH_COMM_PENDING_REQUEST
        ESH_WakeupToRun (BswMRule):
          BswMNestedExecutionOnly = false
          BswMRuleId = 11
          BswMRuleInitState = BSWM_FALSE
          BswMRuleExpressionRef = ESH_LE_WakeupToRun
          BswMRuleTrueActionList = ESH_AL_WakeupToRun
        ESH_LE_WakeupToRun (BswMLogicalExpression): BswMLogicalOperator=BSWM_AND, BswMArgumentRef=ESH_Cond_StateIsWakeup, BswMArgumentRef=ESH_LE_ValidWakeup, BswMArgumentRef=ESH_Cond_ModeIsWakeup
        ESH_InitToWakeup (BswMRule):
          BswMNestedExecutionOnly = false
          BswMRuleId = 1
          BswMRuleInitState = BSWM_FALSE
          BswMRuleExpressionRef = ESH_LE_InitToWakeup
          BswMRuleTrueActionList = ESH_AL_InitToWakeup
        ESH_LE_InitToWakeup (BswMLogicalExpression): BswMLogicalOperator=BSWM_AND, BswMArgumentRef=ESH_Cond_StateIsInit
        ESH_Cond_StateIsInit (BswMModeCondition): BswMConditionType=BSWM_EQUALS, BswMConditionMode=ESH_State
          BswMConditionValue
            BswMBswMode: BswMBswRequestedMode=ESH_INIT
        ESH_PostRunToPrepNested (BswMRule):
          BswMNestedExecutionOnly = true
          BswMRuleId = 4
          BswMRuleInitState = BSWM_FALSE
          BswMRuleExpressionRef = ESH_LE_PostRunToPrep
          BswMRuleTrueActionList = ESH_AL_PostRunToPrepShutdown
        ESH_LE_PostRunToPrep (BswMLogicalExpression): BswMLogicalOperator=BSWM_OR, BswMArgumentRef=ESH_LE_PostRunReleased
        ESH_LE_PostRunReleased (BswMLogicalExpression): BswMLogicalOperator=BSWM_AND, BswMArgumentRef=ESH_Cond_PostRunRequest0IsReleased, BswMArgumentRef=ESH_Cond_PostRunRequest1IsReleased
        ESH_Cond_PostRunRequest0IsReleased (BswMModeCondition): BswMConditionType=BSWM_EQUALS, BswMConditionMode=ESH_PostRunRequest_0
          BswMConditionValue
            BswMModeDeclaration: BswMModeValueRef=RELEASED
        ESH_PostRunRequest_0 (BswMModeRequestPort): BswMArbitrateOnInit=false, BswMRequestProcessing=BSWM_DEFERRED
          BswMModeRequestSource
            BswMSwcModeRequest: BswMModeRequestDataElementPrototypeName=requestedMode, BswMSwcModeRequestModeDeclarationGroupPrototypeRef=BswM_MDGP_ESH_RunRequest
          BswMModeInitValue
            BswMSwcModeInitValue: BswMSwcModeInitValueRef=RELEASED
        ESH_Cond_PostRunRequest1IsReleased (BswMModeCondition): BswMConditionType=BSWM_EQUALS, BswMConditionMode=ESH_PostRunRequest_1
          BswMConditionValue
            BswMModeDeclaration: BswMModeValueRef=RELEASED
        ESH_PostRunRequest_1 (BswMModeRequestPort): BswMArbitrateOnInit=false, BswMRequestProcessing=BSWM_DEFERRED
          BswMModeRequestSource
            BswMSwcModeRequest: BswMModeRequestDataElementPrototypeName=requestedMode, BswMSwcModeRequestModeDeclarationGroupPrototypeRef=BswM_MDGP_ESH_RunRequest
          BswMModeInitValue
            BswMSwcModeInitValue: BswMSwcModeInitValueRef=RELEASED
        ESH_PostRunNested (BswMRule):
          BswMNestedExecutionOnly = true
          BswMRuleId = 3
          BswMRuleInitState = BSWM_FALSE
          BswMRuleExpressionRef = ESH_LE_PostRunToRun
          BswMRuleFalseActionList = ESH_AL_ESH_PostRunToPrepCheck
          BswMRuleTrueActionList = ESH_AL_PostRunToRun
        3 x BswMLogicalExpression:
          ESH_LE_PostRunToRun: BswMLogicalOperator=BSWM_AND, BswMArgumentRef=ESH_LE_RunRequestsOrWakeup
          ESH_LE_RunRequestsOrWakeup: BswMLogicalOperator=BSWM_OR, BswMArgumentRef=ESH_LE_RunRequested, BswMArgumentRef=ESH_LE_ValidWakeup
          ESH_LE_RunRequested: BswMLogicalOperator=BSWM_OR, BswMArgumentRef=ESH_Cond_RunRequest0IsRequested, BswMArgumentRef=ESH_Cond_RunRequest1IsRequested
        ESH_Cond_RunRequest0IsRequested (BswMModeCondition): BswMConditionType=BSWM_EQUALS, BswMConditionMode=ESH_RunRequest_0
          BswMConditionValue
            BswMModeDeclaration: BswMModeValueRef=REQUESTED
        ESH_Cond_RunRequest1IsRequested (BswMModeCondition): BswMConditionType=BSWM_EQUALS, BswMConditionMode=ESH_RunRequest_1
          BswMConditionValue
            BswMModeDeclaration: BswMModeValueRef=REQUESTED
        ESH_PostRun (BswMRule):
          BswMNestedExecutionOnly = false
          BswMRuleId = 2
          BswMRuleInitState = BSWM_FALSE
          BswMRuleExpressionRef = ESH_LE_PostRun
          BswMRuleTrueActionList = ESH_AL_ExitPostRun
        ESH_LE_PostRun (BswMLogicalExpression): BswMLogicalOperator=BSWM_AND, BswMArgumentRef=ESH_Cond_StateIsPostRun, BswMArgumentRef=ESH_Cond_ModeIsPostRun
        ESH_Cond_StateIsPostRun (BswMModeCondition): BswMConditionType=BSWM_EQUALS, BswMConditionMode=ESH_State
          BswMConditionValue
            BswMBswMode: BswMBswRequestedMode=ESH_POST_RUN
        ESH_Cond_ModeIsPostRun (BswMModeCondition): BswMConditionType=BSWM_EQUALS, BswMConditionMode=ESH_ModeNotification
          BswMConditionValue
            BswMModeDeclaration: BswMModeValueRef=POSTRUN
        ESH_PrepToWait (BswMRule):
          BswMNestedExecutionOnly = false
          BswMRuleId = 5
          BswMRuleInitState = BSWM_FALSE
          BswMRuleExpressionRef = ESH_LE_PrepShutdownToWaitForNvM
          BswMRuleTrueActionList = ESH_AL_PrepShutdownToWaitForNvM
        ESH_LE_PrepShutdownToWaitForNvM (BswMLogicalExpression): BswMLogicalOperator=BSWM_AND, BswMArgumentRef=ESH_Cond_StateIsPrepShutdown, BswMArgumentRef=ESH_Cond_ModeIsShutdown
        ESH_Cond_StateIsPrepShutdown (BswMModeCondition): BswMConditionType=BSWM_EQUALS, BswMConditionMode=ESH_State
          BswMConditionValue
            BswMBswMode: BswMBswRequestedMode=ESH_PREP_SHUTDOWN
        ESH_Cond_ModeIsShutdown (BswMModeCondition): BswMConditionType=BSWM_EQUALS, BswMConditionMode=ESH_ModeNotification
          BswMConditionValue
            BswMModeDeclaration: BswMModeValueRef=SHUTDOWN
        CC_CN_CAN00_3ce10f85_TX (BswMRule):
          BswMNestedExecutionOnly = false
          BswMRuleId = 0
          BswMRuleInitState = BSWM_FALSE
          BswMRuleExpressionRef = CC_LE_CN_CAN00_3ce10f85_TX
          BswMRuleFalseActionList = CC_AL_CN_CAN00_3ce10f85_TX_Disable
          BswMRuleTrueActionList = CC_AL_CN_CAN00_3ce10f85_TX_EnableNoinit
        CC_LE_CN_CAN00_3ce10f85_TX (BswMLogicalExpression): BswMLogicalOperator=BSWM_AND, BswMArgumentRef=CC_Cond_CanSMIndication_CN_CAN00_3ce10f85_EQ_CANSM_BSWM_FULL_COMMUNICATION
        CC_Cond_CanSMIndication_CN_CAN00_3ce10f85_EQ_CANSM_BSWM_FULL_COMMUNICATION (BswMModeCondition): BswMConditionType=BSWM_EQUALS, BswMConditionMode=CC_CanSMIndication_CN_CAN00_3ce10f85
          BswMConditionValue
            BswMBswMode: BswMBswRequestedMode=CANSM_BSWM_FULL_COMMUNICATION
        CC_CanSMIndication_CN_CAN00_3ce10f85 (BswMModeRequestPort): BswMArbitrateOnInit=false, BswMRequestProcessing=BSWM_IMMEDIATE
          BswMModeRequestSource
            BswMCanSMIndication: BswMCanSMChannelRef=ComMConfigSet/CN_CAN00_3ce10f85
          BswMModeInitValue
            BswMBswModeInitValue: BswMBswModeInitValueMode=CANSM_BSWM_NO_COMMUNICATION
      BswMModeControl: BswMInitActionListRef=INIT_AL_Initialize
        ESH_AL_ExitRun (BswMActionList): BswMActionListExecution=BSWM_CONDITION
          4 x BswMActionListItem, all with BswMAbortOnFail=false:
            ESH_Action_EnterExclusiveArea: BswMActionListItemIndex=0, BswMActionListItemRef=BswMModeControl/ESH_Action_EnterExclusiveArea
            ESH_Action_ComMCheckPendingRequests: BswMActionListItemIndex=1, BswMActionListItemRef=BswMModeControl/ESH_Action_ComMCheckPendingRequests
            ESH_RunToPostRunNested: BswMActionListItemIndex=2, BswMActionListItemRef=BswMArbitration/ESH_RunToPostRunNested
            ESH_Action_ExitExclusiveArea: BswMActionListItemIndex=3, BswMActionListItemRef=BswMModeControl/ESH_Action_ExitExclusiveArea
        ESH_Action_EnterExclusiveArea (BswMAction)
          BswMAvailableActions
            BswMUserCallout: BswMUserCalloutFunction=SchM_Enter_BswM_BSWM_EXCLUSIVE_AREA_0(), BswMCreateCallout=false, BswMUserIncludeFile=SchM_BswM.h
        ESH_Action_ComMCheckPendingRequests (BswMAction)
          BswMAvailableActions
            BswMUserCallout:
              BswMUserCalloutFunction = ESH_ComM_CheckPendingRequests()
              BswMCreateCallout = true
              BswMUserCode = ComM_StateType CN_CAN00_3ce10f85 = COMM_NO_COM_NO_PENDING_REQUEST; (void)ComM_GetState(ComMConf_ComMChannel_CN_CAN00_3ce10f85, &CN_CAN00_3ce10f85); /* SBSW_BSWM_FCTCALL_LOCALVAR */ if(CN_CAN00_3ce10f85 != COMM_NO_COM_NO_PENDING_REQUEST) { BswM_RequestMode(BSWM_GENERIC_ESH_ComMPendingRequests, BSWM_GENERICVALUE_ESH_ComMPendingRequests_ESH_COMM_PENDING_REQUEST); } else { BswM_RequestMode(BSWM_GENERIC_ESH_ComMPendingRequests, BSWM_GENERICVALUE_ESH_ComMPendingRequests_ESH_COMM_NO_REQUEST); }
        ESH_AL_RunToPostRun (BswMActionList): BswMActionListExecution=BSWM_CONDITION
          5 x BswMActionListItem, all with BswMAbortOnFail=false:
            ESH_Action_ComMDisallow_CN_CAN00_3ce10f85: BswMActionListItemIndex=0, BswMActionListItemRef=BswMModeControl/ESH_Action_ComMDisallow_CN_CAN00_3ce10f85
            ESH_Action_EcuMClearValidatedWakeupEvents: BswMActionListItemIndex=1, BswMActionListItemRef=BswMModeControl/ESH_Action_EcuMClearValidatedWakeupEvents
            ESH_Action_OnEnterPostRun: BswMActionListItemIndex=2, BswMActionListItemRef=BswMModeControl/ESH_Action_OnEnterPostRun
            ESH_Action_SwitchPostRun: BswMActionListItemIndex=3, BswMActionListItemRef=BswMModeControl/ESH_Action_SwitchPostRun
            ESH_Action_ESH_PostRun: BswMActionListItemIndex=4, BswMActionListItemRef=BswMModeControl/ESH_Action_ESH_PostRun
        4 x BswMAction:
          ESH_Action_ComMDisallow_CN_CAN00_3ce10f85
            BswMAvailableActions
              BswMComMAllowCom: BswMComAllowed=false, BswMComMAllowChannelRef=ComMConfigSet/CN_CAN00_3ce10f85
          ESH_Action_EcuMClearValidatedWakeupEvents
            BswMAvailableActions
              BswMUserCallout: BswMUserCalloutFunction=EcuM_ClearValidatedWakeupEvent(ECUM_WKSOURCE_ALL_SOURCES), BswMCreateCallout=false, BswMUserIncludeFile=EcuM.h
          ESH_Action_OnEnterPostRun
            BswMAvailableActions
              BswMUserCallout: BswMUserCalloutFunction=BswM_ESH_OnEnterPostRun(), BswMCreateCallout=true
          ESH_Action_SwitchPostRun
            BswMAvailableActions
              BswMRteSwitch: BswMSwitchedMode=POSTRUN, BswMRteSwitchPortRef=ESH_ModeSwitch
        ESH_ModeSwitch (BswMSwitchPort): BswMModeSwitchInterfaceRef=BswM_MSI_ESH_Mode
        ESH_Action_ESH_PostRun (BswMAction)
          BswMAvailableActions
            BswMGenericModeSwitch: BswMGenericRequestRef=ESH_State, BswMGenericRequestModeRef=ESH_POST_RUN
        ESH_Action_ExitExclusiveArea (BswMAction)
          BswMAvailableActions
            BswMUserCallout: BswMUserCalloutFunction=SchM_Exit_BswM_BSWM_EXCLUSIVE_AREA_0(), BswMCreateCallout=false, BswMUserIncludeFile=SchM_BswM.h
        ESH_AL_WaitForNvMToShutdown (BswMActionList): BswMActionListExecution=BSWM_CONDITION
          ESH_Action_OnEnterShutdown (BswMActionListItem): BswMAbortOnFail=false, BswMActionListItemIndex=0, BswMActionListItemRef=BswMModeControl/ESH_Action_OnEnterShutdown
          ESH_Action_EcuMGoToSelectedShutdownTarget (BswMActionListItem): BswMAbortOnFail=false, BswMActionListItemIndex=1, BswMActionListItemRef=BswMModeControl/ESH_Action_EcuMGoToSelectedShutdownTarget
        ESH_Action_OnEnterShutdown (BswMAction)
          BswMAvailableActions
            BswMUserCallout: BswMUserCalloutFunction=BswM_ESH_OnEnterShutdown(), BswMCreateCallout=true
        ESH_Action_EcuMGoToSelectedShutdownTarget (BswMAction)
          BswMAvailableActions
            BswMUserCallout: BswMUserCalloutFunction=(void)EcuM_GoToSelectedShutdownTarget(), BswMCreateCallout=false, BswMUserIncludeFile=EcuM.h
        ESH_AL_WakeupToPrep (BswMActionList): BswMActionListExecution=BSWM_CONDITION
          3 x BswMActionListItem, all with BswMAbortOnFail=false:
            ESH_Action_OnEnterPrepShutdown: BswMActionListItemIndex=0, BswMActionListItemRef=BswMModeControl/ESH_Action_OnEnterPrepShutdown
            ESH_Action_SwitchShutdown: BswMActionListItemIndex=1, BswMActionListItemRef=BswMModeControl/ESH_Action_SwitchShutdown
            ESH_Action_ESH_PrepShutdown: BswMActionListItemIndex=2, BswMActionListItemRef=BswMModeControl/ESH_Action_ESH_PrepShutdown
        3 x BswMAction:
          ESH_Action_OnEnterPrepShutdown
            BswMAvailableActions
              BswMUserCallout: BswMUserCalloutFunction=BswM_ESH_OnEnterPrepShutdown(), BswMCreateCallout=true
          ESH_Action_SwitchShutdown
            BswMAvailableActions
              BswMRteSwitch: BswMSwitchedMode=SHUTDOWN, BswMRteSwitchPortRef=ESH_ModeSwitch
          ESH_Action_ESH_PrepShutdown
            BswMAvailableActions
              BswMGenericModeSwitch: BswMGenericRequestRef=ESH_State, BswMGenericRequestModeRef=ESH_PREP_SHUTDOWN
        ESH_AL_WaitForNvMWakeup (BswMActionList): BswMActionListExecution=BSWM_CONDITION
          3 x BswMActionListItem, all with BswMAbortOnFail=false:
            ESH_Action_OnEnterWakeup: BswMActionListItemIndex=0, BswMActionListItemRef=BswMModeControl/ESH_Action_OnEnterWakeup
            ESH_Action_SwitchWakeup: BswMActionListItemIndex=1, BswMActionListItemRef=BswMModeControl/ESH_Action_SwitchWakeup
            ESH_Action_ESH_Wakeup: BswMActionListItemIndex=2, BswMActionListItemRef=BswMModeControl/ESH_Action_ESH_Wakeup
        3 x BswMAction:
          ESH_Action_OnEnterWakeup
            BswMAvailableActions
              BswMUserCallout: BswMUserCalloutFunction=BswM_ESH_OnEnterWakeup(), BswMCreateCallout=true
          ESH_Action_SwitchWakeup
            BswMAvailableActions
              BswMRteSwitch: BswMSwitchedMode=WAKEUP, BswMRteSwitchPortRef=ESH_ModeSwitch
          ESH_Action_ESH_Wakeup
            BswMAvailableActions
              BswMGenericModeSwitch: BswMGenericRequestRef=ESH_State, BswMGenericRequestModeRef=ESH_WAKEUP
        ESH_AL_WakeupToRun (BswMActionList): BswMActionListExecution=BSWM_CONDITION
          5 x BswMActionListItem, all with BswMAbortOnFail=false:
            ESH_Action_ComMAllow_CN_CAN00_3ce10f85: BswMActionListItemIndex=0, BswMActionListItemRef=BswMModeControl/ESH_Action_ComMAllow_CN_CAN00_3ce10f85
            ESH_Action_SelfRunRequestTimer_Start: BswMActionListItemIndex=1, BswMActionListItemRef=BswMModeControl/ESH_Action_SelfRunRequestTimer_Start
            ESH_Action_OnEnterRun: BswMActionListItemIndex=2, BswMActionListItemRef=BswMModeControl/ESH_Action_OnEnterRun
            ESH_Action_SwitchRun: BswMActionListItemIndex=3, BswMActionListItemRef=BswMModeControl/ESH_Action_SwitchRun
            ESH_Action_ESH_Run: BswMActionListItemIndex=4, BswMActionListItemRef=BswMModeControl/ESH_Action_ESH_Run
        5 x BswMAction:
          ESH_Action_ComMAllow_CN_CAN00_3ce10f85
            BswMAvailableActions
              BswMComMAllowCom: BswMComAllowed=true, BswMComMAllowChannelRef=ComMConfigSet/CN_CAN00_3ce10f85
          ESH_Action_SelfRunRequestTimer_Start
            BswMAvailableActions
              BswMTimerControl: BswMTimerAction=BSWM_TIMER_START, BswMTimerValue=0.1, BswMTimerRef=ESH_SelfRunRequestTimer
          ESH_Action_OnEnterRun
            BswMAvailableActions
              BswMUserCallout: BswMUserCalloutFunction=BswM_ESH_OnEnterRun(), BswMCreateCallout=true
          ESH_Action_SwitchRun
            BswMAvailableActions
              BswMRteSwitch: BswMSwitchedMode=RUN, BswMRteSwitchPortRef=ESH_ModeSwitch
          ESH_Action_ESH_Run
            BswMAvailableActions
              BswMGenericModeSwitch: BswMGenericRequestRef=ESH_State, BswMGenericRequestModeRef=ESH_RUN
        6 x BswMActionList, all with BswMActionListExecution=BSWM_CONDITION:
          ESH_AL_InitToWakeup
            3 x BswMActionListItem, all with BswMAbortOnFail=false:
              ESH_Action_OnEnterWakeup: BswMActionListItemIndex=0, BswMActionListItemRef=BswMModeControl/ESH_Action_OnEnterWakeup
              ESH_Action_SwitchWakeup: BswMActionListItemIndex=1, BswMActionListItemRef=BswMModeControl/ESH_Action_SwitchWakeup
              ESH_Action_ESH_Wakeup: BswMActionListItemIndex=2, BswMActionListItemRef=BswMModeControl/ESH_Action_ESH_Wakeup
          ESH_AL_PostRunToPrepShutdown
            3 x BswMActionListItem, all with BswMAbortOnFail=false:
              ESH_Action_OnEnterPrepShutdown: BswMActionListItemIndex=0, BswMActionListItemRef=BswMModeControl/ESH_Action_OnEnterPrepShutdown
              ESH_Action_SwitchShutdown: BswMActionListItemIndex=1, BswMActionListItemRef=BswMModeControl/ESH_Action_SwitchShutdown
              ESH_Action_ESH_PrepShutdown: BswMActionListItemIndex=2, BswMActionListItemRef=BswMModeControl/ESH_Action_ESH_PrepShutdown
          ESH_AL_ESH_PostRunToPrepCheck
            ESH_PostRunToPrepNested (BswMActionListItem): BswMAbortOnFail=false, BswMActionListItemIndex=0, BswMActionListItemRef=BswMArbitration/ESH_PostRunToPrepNested
          ESH_AL_PostRunToRun
            5 x BswMActionListItem, all with BswMAbortOnFail=false:
              ESH_Action_ComMAllow_CN_CAN00_3ce10f85: BswMActionListItemIndex=0, BswMActionListItemRef=BswMModeControl/ESH_Action_ComMAllow_CN_CAN00_3ce10f85
              ESH_Action_SelfRunRequestTimer_Start: BswMActionListItemIndex=1, BswMActionListItemRef=BswMModeControl/ESH_Action_SelfRunRequestTimer_Start
              ESH_Action_OnEnterRun: BswMActionListItemIndex=2, BswMActionListItemRef=BswMModeControl/ESH_Action_OnEnterRun
              ESH_Action_SwitchRun: BswMActionListItemIndex=3, BswMActionListItemRef=BswMModeControl/ESH_Action_SwitchRun
              ESH_Action_ESH_Run: BswMActionListItemIndex=4, BswMActionListItemRef=BswMModeControl/ESH_Action_ESH_Run
          ESH_AL_ExitPostRun
            4 x BswMActionListItem, all with BswMAbortOnFail=false:
              ESH_Action_EnterExclusiveArea: BswMActionListItemIndex=0, BswMActionListItemRef=BswMModeControl/ESH_Action_EnterExclusiveArea
              ESH_Action_ComMCheckPendingRequests: BswMActionListItemIndex=1, BswMActionListItemRef=BswMModeControl/ESH_Action_ComMCheckPendingRequests
              ESH_PostRunNested: BswMActionListItemIndex=2, BswMActionListItemRef=BswMArbitration/ESH_PostRunNested
              ESH_Action_ExitExclusiveArea: BswMActionListItemIndex=3, BswMActionListItemRef=BswMModeControl/ESH_Action_ExitExclusiveArea
          ESH_AL_PrepShutdownToWaitForNvM
            3 x BswMActionListItem, all with BswMAbortOnFail=false:
              ESH_Action_ComMCheckPendingRequests: BswMActionListItemIndex=0, BswMActionListItemRef=BswMModeControl/ESH_Action_ComMCheckPendingRequests
              ESH_Action_OnEnterWaitForNvm: BswMActionListItemIndex=1, BswMActionListItemRef=BswMModeControl/ESH_Action_OnEnterWaitForNvm
              ESH_Action_ESH_WaitForNvm: BswMActionListItemIndex=2, BswMActionListItemRef=BswMModeControl/ESH_Action_ESH_WaitForNvm
        ESH_Action_OnEnterWaitForNvm (BswMAction)
          BswMAvailableActions
            BswMUserCallout: BswMUserCalloutFunction=BswM_ESH_OnEnterWaitForNvm(), BswMCreateCallout=true
        ESH_Action_ESH_WaitForNvm (BswMAction)
          BswMAvailableActions
            BswMGenericModeSwitch: BswMGenericRequestRef=ESH_State, BswMGenericRequestModeRef=ESH_WAIT_FOR_NVM
        INIT_AL_Initialize (BswMActionList): BswMActionListExecution=BSWM_CONDITION
          13 x BswMActionListItem, all with BswMAbortOnFail=false:
            INIT_Action_Det_Init: BswMActionListItemIndex=0, BswMActionListItemRef=BswMModeControl/INIT_Action_Det_Init
            INIT_Action_Mcu_Init: BswMActionListItemIndex=1, BswMActionListItemRef=BswMModeControl/INIT_Action_Mcu_Init
            INIT_Action_Can_Init: BswMActionListItemIndex=2, BswMActionListItemRef=BswMModeControl/INIT_Action_Can_Init
            INIT_Action_CanIf_Init: BswMActionListItemIndex=3, BswMActionListItemRef=BswMModeControl/INIT_Action_CanIf_Init
            INIT_Action_Com_Init: BswMActionListItemIndex=4, BswMActionListItemRef=BswMModeControl/INIT_Action_Com_Init
            INIT_Action_PduR_Init: BswMActionListItemIndex=5, BswMActionListItemRef=BswMModeControl/INIT_Action_PduR_Init
            INIT_Action_CanSM_Init: BswMActionListItemIndex=6, BswMActionListItemRef=BswMModeControl/INIT_Action_CanSM_Init
            INIT_Action_NvMReadAll: BswMActionListItemIndex=7, BswMActionListItemRef=BswMModeControl/INIT_Action_NvMReadAll
            INIT_Action_EnableInterrupts: BswMActionListItemIndex=8, BswMActionListItemRef=BswMModeControl/INIT_Action_EnableInterrupts
            INIT_Action_ComM_Init: BswMActionListItemIndex=9, BswMActionListItemRef=BswMModeControl/INIT_Action_ComM_Init
            INIT_Action_Dio_Init: BswMActionListItemIndex=10, BswMActionListItemRef=BswMModeControl/INIT_Action_Dio_Init
            INIT_Action_vSet_Init: BswMActionListItemIndex=11, BswMActionListItemRef=BswMModeControl/INIT_Action_vSet_Init
            INIT_Action_RteStart: BswMActionListItemIndex=12, BswMActionListItemRef=BswMModeControl/INIT_Action_RteStart
        13 x BswMAction:
          INIT_Action_Det_Init
            BswMAvailableActions
              BswMUserCallout: BswMUserCalloutFunction=Det_Init(Det_Config_Ptr), BswMCreateCallout=false, BswMUserIncludeFile=Det.h
          INIT_Action_Mcu_Init
            BswMAvailableActions
              BswMUserCallout:
                BswMUserCalloutFunction = Mcu_InitClock(McuConf_McuClockSettingConfig_McuClockSettingConfig_0); while (MCU_PLL_LOCKED != Mcu_GetPllStatus()); Mcu_DistributePllClock();
                BswMCreateCallout = false
                BswMUserIncludeFile = Mcu.h
          INIT_Action_Can_Init
            BswMAvailableActions
              BswMUserCallout: BswMUserCalloutFunction=Can_Init(Can_Config_Ptr), BswMCreateCallout=false, BswMUserIncludeFile=Can.h
          INIT_Action_CanIf_Init
            BswMAvailableActions
              BswMUserCallout: BswMUserCalloutFunction=CanIf_Init(CanIf_Config_Ptr), BswMCreateCallout=false, BswMUserIncludeFile=CanIf.h
          INIT_Action_Com_Init
            BswMAvailableActions
              BswMUserCallout: BswMUserCalloutFunction=Com_Init(Com_Config_Ptr), BswMCreateCallout=false, BswMUserIncludeFile=Com.h
          INIT_Action_PduR_Init
            BswMAvailableActions
              BswMUserCallout: BswMUserCalloutFunction=PduR_Init(PduR_Config_Ptr), BswMCreateCallout=false, BswMUserIncludeFile=PduR.h
          INIT_Action_CanSM_Init
            BswMAvailableActions
              BswMUserCallout: BswMUserCalloutFunction=CanSM_Init(CanSM_Config_Ptr), BswMCreateCallout=false, BswMUserIncludeFile=CanSM_EcuM.h
          INIT_Action_NvMReadAll
            BswMAvailableActions
              BswMUserCallout: BswMUserCalloutFunction=BswM_INIT_NvMReadAll(), BswMCreateCallout=true
          INIT_Action_EnableInterrupts
            BswMAvailableActions
              BswMUserCallout: BswMUserCalloutFunction=BswM_AL_SetProgrammableInterrupts(), BswMCreateCallout=true
          INIT_Action_ComM_Init
            BswMAvailableActions
              BswMUserCallout: BswMUserCalloutFunction=ComM_Init(), BswMCreateCallout=false, BswMUserIncludeFile=ComM.h
          INIT_Action_Dio_Init
            BswMAvailableActions
              BswMUserCallout: BswMUserCalloutFunction=Dio_Init(NULL_PTR), BswMCreateCallout=false, BswMUserIncludeFile=Dio.h
          INIT_Action_vSet_Init
            BswMAvailableActions
              BswMUserCallout: BswMUserCalloutFunction=vSet_Init(NULL_PTR), BswMCreateCallout=false, BswMUserIncludeFile=vSet.h
          INIT_Action_RteStart
            BswMAvailableActions
              BswMUserCallout: BswMUserCalloutFunction=(void)Rte_Start(), BswMCreateCallout=false, BswMUserIncludeFile=Rte_Main.h
        CC_AL_CN_CAN00_3ce10f85_TX_Disable (BswMActionList): BswMActionListExecution=BSWM_TRIGGER
          CC_DisablePDUGroup_Veh_Door_oCAN00_Tx_2fd3c8d8 (BswMActionListItem): BswMAbortOnFail=false, BswMActionListItemIndex=0, BswMActionListItemRef=BswMModeControl/CC_DisablePDUGroup_Veh_Door_oCAN00_Tx_2fd3c8d8
        CC_DisablePDUGroup_Veh_Door_oCAN00_Tx_2fd3c8d8 (BswMAction)
          BswMAvailableActions
            BswMPduGroupSwitch: BswMPduGroupSwitchReinit=false, BswMDisabledPduGroupRef=Veh_Door_oCAN00_Tx_2fd3c8d8
        CC_AL_CN_CAN00_3ce10f85_TX_EnableNoinit (BswMActionList): BswMActionListExecution=BSWM_TRIGGER
          CC_EnablePDUGroup_Veh_Door_oCAN00_Tx_2fd3c8d8 (BswMActionListItem): BswMAbortOnFail=false, BswMActionListItemIndex=0, BswMActionListItemRef=BswMModeControl/CC_EnablePDUGroup_Veh_Door_oCAN00_Tx_2fd3c8d8
        CC_EnablePDUGroup_Veh_Door_oCAN00_Tx_2fd3c8d8 (BswMAction)
          BswMAvailableActions
            BswMPduGroupSwitch: BswMPduGroupSwitchReinit=false, BswMEnabledPduGroupRef=Veh_Door_oCAN00_Tx_2fd3c8d8
      ESH_Mode (BswMRteModeDclGroup): BswMInitMode=STARTUP
        5 x BswMRteMode:
          STARTUP: BswMModePhysicalValue=0
          RUN: BswMModePhysicalValue=1
          POSTRUN: BswMModePhysicalValue=2
          WAKEUP: BswMModePhysicalValue=3
          SHUTDOWN: BswMModePhysicalValue=4
      ESH_RunRequest (BswMRteModeDclGroup): BswMInitMode=RELEASED
        RELEASED (BswMRteMode): BswMModePhysicalValue=0
        REQUESTED (BswMRteMode): BswMModePhysicalValue=1
      BswMDataTypeMappingSets: BswMDataTypeMappingSetRef=BswMMappingSet
  module config vSet: implementation-config-variant=VARIANT-PRE-COMPILE, module-description=vSet_Impl
    vSetCalibration
    vSetGeneral: vSetDummyStatementKind=SelfAssignment
    vSetPlatform:
      vSetCPUType = CPU32Bit
      vSetSizeOfRAMPointer = Size32Bit
      vSetSizeOfEnum = Size32Bit
      vSetSizeOfROMPointer = Size32Bit
      vSetByteOrder = LITTLE_ENDIAN
      vSetBitOrder = LSB_to_MSB
      vSetSizeOfInt = Size32Bit
  module config Dio: implementation-config-variant=VARIANT-PRE-COMPILE, module-description=Dio_Impl
    DioConfig
      DioPort: DioPortId=0
        3 x DioChannel:
          env_InteriorLightFront: DioChannelId=0
          env_DoorFrontLeft: DioChannelId=1
          env_DoorFrontRight: DioChannelId=2
    DioGeneral:
      DioDevErrorDetect = false
      DioVersionInfoApi = false
      DioReversePortBits = false
      DioFlipChannelApi = false
      DioReadZeroForUndefinedPortPins = false
      DioMaskedWritePortApi = false
      DioEnableUserModeSupport = false
    CommonPublishedInformation:
      ArReleaseMajorVersion = 4
      ArReleaseMinorVersion = 2
      ArReleaseRevisionVersion = 2
      ModuleId = 120
      SwMajorVersion = 1
      SwMinorVersion = 0
      SwPatchVersion = 1
      VendorId = 43
  module config NvM: implementation-config-variant=VARIANT-PRE-COMPILE, module-description=NvM_Impl
    NvMConfigBlock (NvMBlockDescriptor):
      NvMBlockCrcType = NVM_CRC16
      NvMBlockManagementType = NVM_BLOCK_REDUNDANT
      NvMInitBlockCallback = NULL_PTR
      NvMResistantToChangedSw = true
      NvMSelectBlockForReadAll = true
      NvMSelectBlockForWriteAll = true
      NvMUseInitCallback = false
      NvMUseJobendCallback = false
      NvMSingleBlockCallback = NULL_PTR
      NvMBswMBlockStatusInformation = false
      NvMBlockUseCrc = true
      NvMBlockUseSyncMechanism = false
      NvMCalcRamBlockCrc = false
      NvMUseServicePorts = false
      NvMNvramBlockIdentifier = 1
      NvMNvBlockNum = 2
      NvMNvBlockLength = 2
      NvMRomBlockDataAddress = NULL_PTR
      NvMBlockJobPriority = 127
      NvMBlockWriteProt = false
      NvMWriteBlockOnce = false
      NvMBlockUseCRCCompMechanism = false
      NvMTargetBlockReference
    NvMCommon:
      NvMDevErrorDetect = true
      NvMVersionInfoApi = false
      NvMApiConfigClass = NVM_API_CONFIG_CLASS_3
      NvMBswMMultiBlockJobStatusInformation = false
      NvMCompiledConfigId = 1
      NvMCrcNumOfBytes = 64
      NvMDatasetSelectionBits = 4
      NvMDrvModeSwitch = true
      NvMDynamicConfiguration = false
      NvMJobPrioritization = false
      NvMPollingMode = true
      NvMSetRamBlockStatusApi = true
      NvMSizeStandardJobQueue = 8
      NvMMaxNoOfWriteRetries = 1
      NvMMainFunctionPeriod = 0.01
      NvMUseBlockIdCheck = false
      NvMRepairRedundantBlocksApi = false
      NvMSafeBswChecks = false
    NvMCommonVendorParams: NvMMultiblockId=MultiBlockRequest, NvMCrcIntBuffer=true, NvMKillWriteAllApi=true
    4 x NvMBlockDescriptor, all with NvMBlockCrcType=NVM_CRC16, NvMBlockManagementType=NVM_BLOCK_NATIVE, NvMInitBlockCallback=NULL_PTR, NvMSelectBlockForReadAll=true, NvMUseInitCallback=false, NvMSingleBlockCallback=NULL_PTR, NvMBswMBlockStatusInformation=false, NvMBlockUseCrc=true, NvMBlockUseSyncMechanism=false, NvMCalcRamBlockCrc=false, NvMBlockJobPriority=127, NvMBlockWriteProt=false, NvMNvBlockLength=1, NvMNvBlockNum=1, NvMWriteBlockOnce=false, NvMBlockUseCRCCompMechanism=false:
      Rte_NvmBlock_CpApMySwc_PimOdometer: NvMResistantToChangedSw=true, NvMSelectBlockForWriteAll=false, NvMUseJobendCallback=false, NvMNvramBlockIdentifier=2, NvMUseServicePorts=false
        NvMTargetBlockReference
          NvMFeeRef: NvMNameOfFeeBlock=FeeRte_NvmBlock_CpApMySwc_PimOdometer
      Rte_NvmBlock_CpApMySwc_PimLightOnOffCounter: NvMResistantToChangedSw=true, NvMSelectBlockForWriteAll=false, NvMUseJobendCallback=false, NvMNvramBlockIdentifier=5, NvMUseServicePorts=false
        NvMTargetBlockReference
          NvMFeeRef: NvMNameOfFeeBlock=FeeRte_NvmBlock_CpApMySwc_PimLightOnOffCounter
      CpApMySwcSnNvMPimLightOnOffCounter: NvMResistantToChangedSw=false, NvMSelectBlockForWriteAll=true, NvMUseJobendCallback=false, NvMNvramBlockIdentifier=3, NvMUseServicePorts=true, NvMRamBlockDataAddress=TO_BE_DEFINED_BY_RTE  # UC:Derived from NvBlockNeeds
        NvMTargetBlockReference
          NvMEaRef: NvMNameOfEaBlock=EaCpApMySwcSnNvMPimLightOnOffCounter
      CpApMySwcSnNvMPimOdometer: NvMResistantToChangedSw=false, NvMSelectBlockForWriteAll=true, NvMUseJobendCallback=true, NvMNvramBlockIdentifier=4, NvMUseServicePorts=true, NvMRamBlockDataAddress=TO_BE_DEFINED_BY_RTE, NvMRomBlockDataAddress=TO_BE_DEFINED_BY_RTE  # UC:Derived from NvBlockNeeds
        NvMTargetBlockReference
          NvMEaRef: NvMNameOfEaBlock=EaCpApMySwcSnNvMPimOdometer
  module config Ea: implementation-config-variant=VARIANT-PRE-COMPILE, module-description=Ea_Impl
    EaGeneral:
      EaSetModeSupported = true
      EaDevErrorDetect = true
      EaIndex = 0
      EaPollingMode = true
      EaVersionInfoApi = false
      EaVirtualPageSize = 8
      EaNvMCallbackIncludeFile = NvM_Cbk.h
      EaCorrectSingleBitFlips = true
      EaMainFunctionPeriod = 0.005
      EaMainFunctionTriggering = FixedCycleTime
      EaSafeBswChecks = false
    EaBlockConfiguration:
      EaBlockNumber = 16
      EaBlockSize = 8
      EaImmediateData = false
      EaNumberOfWriteCycles = 10000
      EaNumberOfDatasets = 1
      EaNumberOfInstances = 1
      EaVerifyWrittenData = false
      EaBlockId = 0
      EaPartition = (unset)
    EaPublishedInformation: EaBlockOverhead=2, EaMaximumBlockingTime=0, EaPageOverhead=0
    EaPartitionConfiguration: EaPartitionStartAddress=0, EaPartitionSize=256, EaPartitionAddressAlignment=1, EaPartitionWriteAlignment=1, EaPartitionDevice=(unset)
    EaCpApMySwcSnNvMPimLightOnOffCounter (EaBlockConfiguration):
      EaBlockNumber = 32
      EaBlockSize = 3
      EaImmediateData = false
      EaNumberOfWriteCycles = 10000
      EaNumberOfDatasets = 1
      EaNumberOfInstances = 1
      EaVerifyWrittenData = false
      EaBlockId = 0
      EaPartition = (unset)
    EaCpApMySwcSnNvMPimOdometer (EaBlockConfiguration):
      EaBlockNumber = 48
      EaBlockSize = 3
      EaImmediateData = false
      EaNumberOfWriteCycles = 10000
      EaNumberOfDatasets = 1
      EaNumberOfInstances = 1
      EaVerifyWrittenData = false
      EaBlockId = 0
      EaPartition = (unset)
  module config Fee: implementation-config-variant=VARIANT-PRE-COMPILE
    FeeRte_NvmBlock_CpApMySwc_PimOdometer (FeeBlockConfiguration): FeeBlockNumber=(unset), FeeBlockSize=(unset), FeeImmediateData=(unset), FeeNumberOfWriteCycles=(unset), FeeDeviceIndex=(unset)
    FeeGeneral:
      FeeDevErrorDetect = (unset)
      FeeIndex = (unset)
      FeePollingMode = (unset)
      FeeSetModeSupported = (unset)
      FeeVersionInfoApi = (unset)
      FeeVirtualPageSize = (unset)
    FeePublishedInformation: FeeBlockOverhead=(unset), FeeMaximumBlockingTime=(unset), FeePageOverhead=(unset)
    FeeRte_NvmBlock_CpApMySwc_PimLightOnOffCounter (FeeBlockConfiguration): FeeBlockNumber=(unset), FeeBlockSize=(unset), FeeImmediateData=(unset), FeeNumberOfWriteCycles=(unset), FeeDeviceIndex=(unset)
