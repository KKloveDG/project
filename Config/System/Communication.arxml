AUTOSAR XML (schema 4-2-1)
package /VehicleProject
  system System
package /Cluster
  can cluster CAN00: protocol-name=CAN  # Demo
    can physical channel CHNL: comm-connectors=CN_CAN00
      frame PpDoorStateFrontLeft_oCAN00: id 0x125, from Veh_Door, frame-length=8, can-addressing-mode=STANDARD
        pdu PpDoorStateFrontLeft_oCAN00: length=8, unused-bit-pattern=0
          signal PpLDoorState_oPpDoorStateFrontLeft_oCAN00: start 0, 2 bit, little-endian, base-type=uint8, compu-method=CM_PpLDoorState, transfer-property=PENDING
      frame PpDoorStateFrontRight_oCAN00: id 0x124, from Veh_Door, frame-length=8, can-addressing-mode=STANDARD
        pdu PpDoorStateFrontRight_oCAN00: length=8, unused-bit-pattern=0
          signal PpRDoorState_oPpDoorStateFrontRight_oCAN00: start 0, 2 bit, little-endian, base-type=uint8, compu-method=CM_PpRDoorState, transfer-property=PENDING
      frame PpLightStateFront_oCAN00: id 0x123, from Veh_Door, frame-length=8, can-addressing-mode=STANDARD
        pdu PpLightStateFront_oCAN00: length=8, unused-bit-pattern=0
          signal PpLightState_oPpLightStateFront_oCAN00: start 0, 2 bit, little-endian, base-type=uint8, compu-method=CM_PpLightState, transfer-property=PENDING
package /ECU
  ecu instance Veh_Door: associated-com-i-pdu-group=Veh_Door_oCAN00_Tx
    can communication controller CT_CAN00
    can communication connector CN_CAN00: comm-controller=CT_CAN00
package /IPDUGroup
  i signal i pdu group Veh_Door_oCAN00_Tx: communication-direction=OUT, i-signal-i-pdus=[PpDoorStateFrontLeft_oCAN00, PpDoorStateFrontRight_oCAN00, PpLightStateFront_oCAN00]
