AUTOSAR XML (schema 4-2-1)
package /COM/VECTOR/CFG/WORKFLOW/SYSDESC/SYNC
  flat map FLATMAP
    13 x flat instance descriptor:
      CpApMySwc: upstream-reference=EcuSwComposition.CpCoApplication.CpApMySwc, ecu-extract-reference=COMPOSITIONTYPE.CpApMySwc
      CpSaDoorFrontLeft: upstream-reference=EcuSwComposition.CpCoApplication.CpSaDoorFrontLeft, ecu-extract-reference=COMPOSITIONTYPE.CpSaDoorFrontLeft
      CpSalnteriorLight: upstream-reference=EcuSwComposition.CpCoApplication.CpSalnteriorLight, ecu-extract-reference=COMPOSITIONTYPE.CpSalnteriorLight
      CpSaDoorFrontRight: upstream-reference=EcuSwComposition.CpCoApplication.CpSaDoorFrontRight, ecu-extract-reference=COMPOSITIONTYPE.CpSaDoorFrontRight
      PpDoorStateRearLeft: upstream-reference=EcuSwComposition.PpDoorStateRearLeft, ecu-extract-reference=COMPOSITIONTYPE.PpDoorStateRearLeft
      PpDoorStateRearRight: upstream-reference=EcuSwComposition.PpDoorStateRearRight, ecu-extract-reference=COMPOSITIONTYPE.PpDoorStateRearRight
      PpLightstateRear: upstream-reference=EcuSwComposition.PpLightstateRear, ecu-extract-reference=COMPOSITIONTYPE.PpLightstateRear
      CtCddloHwAb: upstream-reference=EcuSwComposition.CpCoApplication.CtCddloHwAb, ecu-extract-reference=COMPOSITIONTYPE.CtCddloHwAb
      CpApMySwcPpNvMLightOnOffCtApMySwcNvM_PS_CpApMySwcSnNvMPimLightOnOffCounter: upstream-reference=COMPOSITIONTYPE.CpApMySwc.SnNvMPimLightOnOffCounter, ecu-extract-reference=CpApMySwcPpNvMLightOnOffCtApMySwcNvM_PS_CpApMySwcSnNvMPimLightOnOffCounter
      CpApMySwcSnNvMPimLightOnOffCounter: upstream-reference=COMPOSITIONTYPE.CpApMySwc.SnNvMPimLightOnOffCounter
      CpApMySwcPpNvMNotifyJobFinishedOdometerCtApMySwcNvM_NvM_RpNotifyJobEnd_CpApMySwcSnNvMPimOdometer: upstream-reference=COMPOSITIONTYPE.CpApMySwc.SnNvMPimOdometer, ecu-extract-reference=CpApMySwcPpNvMNotifyJobFinishedOdometerCtApMySwcNvM_NvM_RpNotifyJobEnd_CpApMySwcSnNvMPimOdometer
      CpApMySwcPpNvMOdometerCtApMyswcNvM_PS_CpApMySwcSnNvMPimOdometer: upstream-reference=COMPOSITIONTYPE.CpApMySwc.SnNvMPimOdometer, ecu-extract-reference=CpApMySwcPpNvMOdometerCtApMyswcNvM_PS_CpApMySwcSnNvMPimOdometer
      CpApMySwcSnNvMPimOdometer: upstream-reference=COMPOSITIONTYPE.CpApMySwc.SnNvMPimOdometer
