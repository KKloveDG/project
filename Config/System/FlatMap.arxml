AUTOSAR XML (schema 4-2-1)
package /COM/VECTOR/CFG/WORKFLOW/SYSDESC/SYNC
  flat map FLATMAP
    4 x flat instance descriptor:
      CpApMySwc: upstream-reference=EcuSwComposition.CpCoApplication.CpApMySwc, ecu-extract-reference=COMPOSITIONTYPE.CpApMySwc
      CpSaDoorFrontLeft: upstream-reference=EcuSwComposition.CpCoApplication.CpSaDoorFrontLeft, ecu-extract-reference=COMPOSITIONTYPE.CpSaDoorFrontLeft
      CpSalnteriorLight: upstream-reference=EcuSwComposition.CpCoApplication.CpSalnteriorLight, ecu-extract-reference=COMPOSITIONTYPE.CpSalnteriorLight
      CpSaDoorFrontRight: upstream-reference=EcuSwComposition.CpCoApplication.CpSaDoorFrontRight, ecu-extract-reference=COMPOSITIONTYPE.CpSaDoorFrontRight
